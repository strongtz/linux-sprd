## drivers/soc/sprd/debug/dmc_mpu/Kconfig
```kconfig
config SPRD_DMC_MPU_CORE
	bool "Spreadtrum DMC MPU Core Support"
	depends on SPRD_DEBUG
	help
	  Say Y here to support the dmc mpu core.

config SPRD_DMC_MPU
	bool "Spreadtrum DMC MPU Support"
	depends on SPRD_DEBUG
	select SPRD_DMC_MPU_CORE
	help
	  Say Y here to support dmc mpu support.

config SPRD_DMC_MPU_R3P0
	bool "Spreadtrum DMC MPU R3P0 Support"
	depends on SPRD_DEBUG
	help
	  Say Y here to support R3P0 dmc mpu support.
```

## drivers/soc/sprd/debug/irq/Kconfig
```kconfig
config SPRD_EIRQSOFF
	bool "spreadtrum IRQ disable time debug"
	depends on IRQSOFF_TRACER && SPRD_DEBUG
	default y

config SPRD_IRQS_MONITOR
	bool "spreadtrum IRQ brusty debug"
	depends on SPRD_DEBUG
	default n
	help
	    debug Sudden increase interruption for a period of time
```

## drivers/soc/sprd/debug/sysdump/Kconfig
```kconfig
config SPRD_SYSDUMP
	bool "Enable SPRD sysdump handler"
	help
		This option enables Spreatrum sysdump which prepare debug info
		for u-boot to write into mmc storage after kernel panics.
config SPRD_MINI_SYSDUMP
        depends on SPRD_SYSDUMP
        bool "Enable SPRD mini sysdump handler"
        help
                This option enables Spreatrum mini sysdump which supplies simple
                debug info for projects can not support external sd card after
                system occurs kernel panics.
```

## drivers/soc/sprd/domain/Kconfig
```kconfig
config DISP_PM_DOMAIN_SHARKL3
	bool "SPRD Display PM Generic Domain for SharkL3"
	select PM_GENERIC_DOMAINS if PM
	help
	  When you select this feature, it will enable the pm generic
	  power domain for SharkL3 display module.

config SPRD_MM_PW_DOMAIN_R6P0
	bool "Unisoc MM System Power Domain r6p0"
	help
	  This is a power domain driver for mm sys.

config SPRD_CAM_PW_DOMAIN_R5P0
	bool "SPRD Cam System Power Domain r5p0"
	help
	  This is a power domain driver for cam sys.

config SPRD_CAM_PW_DOMAIN_R5P1
	bool "SPRD Cam System Power Domain r5p1"
	help
	  This is a power domain driver for cam sys.

config SPRD_CAM_PW_DOMAIN_R7P0
	bool "SPRD Cam System Power Domain r7p0"
	help
	  This is a power domain driver for cam sys.

config SPRD_CAM_PW_DOMAIN_R4P0
        bool "SPRD Cam System Power Domain r4p0"
        help
          This is a power domain driver for cam sys.
```

## drivers/soc/sprd/iommu/Kconfig
```kconfig
config SPRD_IOMMU
	tristate "SPRD Soc IOMMU Module"
	depends on ARCH_SPRD
	---help---
	  Choose this option can support sprd iommu driver, which can use as an address translater
	  for Device DMA address access, support above 4G address access and scatter pages
	  access.
```

## drivers/soc/sprd/modem/Kconfig
```kconfig
source "drivers/soc/sprd/modem/sipc/Kconfig"
source "drivers/soc/sprd/modem/cproc/Kconfig"
source "drivers/soc/sprd/modem/iq/Kconfig"
source "drivers/soc/sprd/modem/dvfs/Kconfig"
source "drivers/soc/sprd/modem/mcd/Kconfig"
source "drivers/soc/sprd/modem/pcie/Kconfig"
source "drivers/soc/sprd/modem/modem_loader/Kconfig"
source "drivers/soc/sprd/modem/crypto/Kconfig"
```

## drivers/soc/sprd/modem/cproc/Kconfig
```kconfig
config SPRD_CPROC
	tristate "SPRD Communication Processor Driver"
	default n
	help
	  spreadtrum modem communication processor driver.
```

## drivers/soc/sprd/modem/crypto/Kconfig
```kconfig
config SPRD_CRYPTO
	tristate "Spreadtrum Crypto Driver for verifying modem image"
	depends on ARM64
	default n
	help
	  spreadtrum crypto driver for verifying modem image.

config SPRD_CRYPTO_TEST
	tristate "The Testing option of Spreadtrum Crypto Driver for verifying modem image"
	depends on ARM64
	default n
	help
	  The Testing option of spreadtrum crypto driver for verifying modem image.

config SPRD_CRYPTO_PERFORMANCE_TEST
	tristate "The Performance Testing option of Spreadtrum Crypto Driver"
	depends on SPRD_CRYPTO_TEST
	default n
	help
	  The Testing option of spreadtrum crypto driver for verifying modem image.

config SPRD_CRYPTO_SW
	tristate "The Soft Crypto option of Spreadtrum Crypto Driver"
	default n
	help
	  The Testing option of spreadtrum crypto driver for verifying modem image.
```

## drivers/soc/sprd/modem/dvfs/Kconfig
```kconfig
config SPRD_HW_DEVICE_DVFS_CP
	bool "Spreadtrum CP dvfs driver"
	depends on SPRD_SIPC
	help
	  This driver supports dvfs interfaces for PUBCP DVFS and WTLCP DVFS at user specidied.
```

## drivers/soc/sprd/modem/iq/Kconfig
```kconfig
menu "SPRD IQ modules"

config SPRD_IQ
	bool "Sprd IQ"
	default n
	help
	  capture the iq data.

endmenu
```

## drivers/soc/sprd/modem/modem_loader/Kconfig
```kconfig
config SPRD_MODEM_LOADER
	tristate "SPRD Modem Loader"
	default n
	help
	  SPRD modem loader driver. It be user for modem poweron,
	  modem image load, modem memory dump, modem boot and modem reset.

config SPRD_EXT_MODEM
	tristate "SPRD External Modem support"
	default n
	depends on SPRD_MODEM_LOADER
	help
	  This feature used to decide the modem type is external modem.
```

## drivers/soc/sprd/modem/pcie/Kconfig
```kconfig
config SPRD_PCIE_EP_DEVICE
	tristate "SPRD PCIE EP device"
	default n
	depends on PCI_MSI
	help
	  SPRD pcie ep device driver in host side for Spreadtrum.
```

## drivers/soc/sprd/modem/sipc/Kconfig
```kconfig
menu "SIPC modules"

config SPRD_SIPC
	bool "Sprd IPC"
	default n
	help
	  SIPC is a module for spreadtrum AP/CP communicaiton system.

config SPRD_SIPC_V2
	bool "Sprd IPC V2"
	default n
	depends on SPRD_SIPC
	help
	  This driver is a sipc v2 driver for support pcie external modem.
	  the sipc v2 dirver also can support the old sipc, but it has not
	  beem fully verified, so we still keep the old sipc driver. After
	  orca bringup, we will only keep the new version, and the feature
	  SPRD_SIPC_V2 will be remove.

config SPRD_SIPC_SPIPE
	bool "SPRD pipe driver based on SBUF"
	default n
	depends on SPRD_SIPC
	help
	  This driver is a pipe driver base on SBUF, which create
	  general pipes between AP & CP.

config SPRD_SIPC_SPOOL
	bool "SPRD pool driver based on SBLOCK"
	default n
	depends on SPRD_SIPC
	help
	  This driver is a pool driver base on SBLOCK, which create
	  general pools between AP & CP.

config SPRD_SIPC_ZERO_COPY_SIPX
	bool "Enable SETH use SIPX to transfer IP packets"
	default n
	depends on SPRD_SIPC
	help
	  Starting from SharkL5.1, use SIPX to replace SBlock or Seblock for SETH.

config SPRD_SIPC_MEM_CACHE_EN
	bool "Enable cache from sipc memory "
	default n
	depends on SPRD_SIPC_ZERO_COPY_SIPX
	help
	  Enable cache from sipc memory.

config SPRD_SIPC_SETH
    bool "Sprd Ethernet driver"
    default n
    depends on SPRD_SIPC
    help
       This driver supports the Spreadtrum Ethernet based on share
       memory. Say Y here if you want to use it.

config SPRD_SIPC_SETH_RAWIP
	bool "Enable SETH  transfer RawIP packets"
	default n
	depends on SPRD_SIPC
	help
		Starting from SharkL5.1, use zero copy rawip transfer.

config SPRD_SIPC_SWCNBLK
	bool "Enable WCN use wcnblk to transfer IP packets"
	default n
	depends on SPRD_SIPC
	help
	  This driver supports wcn sblock special function.
	  Starting from SharkLe, wcn use swcnblk to replace sblock.

endmenu
```

## drivers/soc/sprd/performance/Kconfig
```kconfig
config SPRD_PTM
	bool "Spreadtrum Performance Trace Monitor Support"
	depends on SPRD_DEBUG
	help
	  Say Y here to support ptm support.
```

## drivers/soc/sprd/pub/Kconfig
```kconfig
config SPRD_DMC_DRV
	bool "Spreadtrum DMC DRV Support"
	depends on ARCH_SPRD
	default n
	help
	  Say Y here to support dmc drv.
```

## drivers/staging/android/Kconfig
```kconfig
menu "Android"

if ANDROID

config ASHMEM
	bool "Enable the Anonymous Shared Memory Subsystem"
	default n
	depends on SHMEM
	---help---
	  The ashmem subsystem is a new shared memory allocator, similar to
	  POSIX SHM but with different behavior and sporting a simpler
	  file-based API.

	  It is, in theory, a good memory allocator for low-memory devices,
	  because it can discard shared memory units when under memory pressure.

config ANDROID_LOW_MEMORY_KILLER
	bool "Android Low Memory Killer"
	---help---
	  Registers processes to be killed when low memory conditions, this is useful
	  as there is no particular swap space on android.

	  The registered process will kills according to the priorities in android init
	  scripts (/init.rc), and it defines priority values with minimum free memory size
	  for each priority.

config ANDROID_LOW_MEMORY_KILLER_AUTODETECT_OOM_ADJ_VALUES
	bool "Android Low Memory Killer: detect oom_adj values"
	depends on ANDROID_LOW_MEMORY_KILLER
	default y
	---help---
	  Detect oom_adj values written to
	  /sys/module/lowmemorykiller/parameters/adj and convert them
	  to oom_score_adj values.

config OOM_NOTIFIER
	bool  "Android OOM Notifier"
	default n
	help
	Using a Android-Style oom-killer instead of linux's native OOM_killer.

config MULTIPLE_OOM_KILLER
	bool "kill multiple tasks"
	depends on OOM_NOTIFIER
	default y
	help
	lmk select multiple tasks to kill when oom

config MULTIPLE_OOM_KILL_COUNT
	int "Maxinum count of tasks will be killed by lmk when oom"
	depends on OOM_NOTIFIER
	default 3
	help
	lmk select multiple tasks to kill when oom

config ANDROID_LOW_MEMORY_KILLER_MEMINFO
	bool "Show Meminfo when lmk invoked"
	default n
	help
	  Show memory information when lmk kills process

config LOWMEM_NOTIFY_KOBJ
	bool "lowmem notify by kobj"
	default n
	---help---
	  notify user-land app when the system is in low memory, currently only used by kaios

config ANDROID_VSOC
	tristate "Android Virtual SoC support"
	default n
	depends on PCI_MSI
	---help---
	  This option adds support for the Virtual SoC driver needed to boot
	  a 'cuttlefish' Android image inside QEmu. The driver interacts with
	  a QEmu ivshmem device. If built as a module, it will be called vsoc.

source "drivers/staging/android/ion/Kconfig"

endif # if ANDROID

endmenu
```

## drivers/staging/sprd/Kconfig
```kconfig
source "drivers/staging/sprd/mailbox/Kconfig"

source "drivers/staging/sprd/sipa/Kconfig"

source "drivers/staging/sprd/pam_ipa/Kconfig"

source "drivers/staging/sprd/sipa_sys/Kconfig"

source "drivers/staging/sprd/sipa_delegate/Kconfig"

config SPRD_DATA_TRANSPORTER
	tristate "SPRD Data Transporter"
	default n
	depends on SPRD_SIPC
	help
	  The data transporter for SC9650 miniAP.

source "drivers/staging/sprd/sfp/Kconfig"
source "drivers/staging/sprd/debug_log/Kconfig"
```

## drivers/staging/sprd/mailbox/Kconfig
```kconfig
menu "SPRD Mailbox  modules"

config SPRD_MAILBOX
	bool "Spreadtrum Mailbox IPI Arch"
	default n
	help
	  Spreadtrum Mailbox is a framework to control
	  hardware communication between on-chip processors
	  through queued messages and interrupt driven
	  signals.

config SPRD_MAILBOX_R1P2
	bool "Spreadtrum Mailbox R1P2 Version"
        default n
	depends on SPRD_MAILBOX
	help
	  This feature be opened indicate that the mailbox
	  module will use the mailbox r1p2 version.

config SPRD_MAILBOX_R2P0
	bool "Spreadtrum Mailbox R2P0 Version"
        default n
	depends on SPRD_MAILBOX
	help
	  This feature be opened indicate that the mailbox
	  module will use the mailbox r2p0 version.

endmenu
```

## drivers/staging/sprd/pam_ipa/Kconfig
```kconfig
menu "PAM IPA modules"

config SPRD_PAM_IPA
	bool "Sprd PAM IPA"
	default SPRD_SIPA
	help
	  PAM IPA is a module for connect SIPA and modem.

endmenu
```

## drivers/staging/sprd/sfp/Kconfig
```kconfig
menu "SFP modules"

config SPRD_SFP_SUPPORT
	bool "Software Network Fast Processing (SFP) Support"
	depends on ARCH_SPRD && NF_CONNTRACK
	default n
	help
		Choosing this option will include conntrack support in the image.
		This will enable fast path rule from conntrack.
		Include api for net drivers.
		Support soft and hardware fast path.

config SPRD_SFP_TEST
	bool "Do snfp test"
	depends on SPRD_SFP_SUPPORT
	default n
	help
		This will include ipa test module.
		Do snfp slef test.
		echo n to test proc file
		to run foward rule config

config SPRD_IPA_SUPPORT
	bool "Sfp ipa config"
	depends on SPRD_SFP_SUPPORT && SPRD_SIPA
	default n
	help
		Sfp ipa configurations.
		This will enable hardware fast path.
		Hash table and entries on dma.
		Software fastpath will disnable when this marco open.
endmenu
```

## drivers/staging/sprd/sipa/Kconfig
```kconfig
menu "SIPA modules"

config SPRD_SIPA
	bool "Sprd IPA"
	default n
	help
	  SIPA is a module for spreadtrum ip packet accelator driver.

config SPRD_SIPA_WCN
	bool "Enable sipa for WCN"
	default n
	depends on SPRD_SIPA
	help
	  This option enables sipa interface for WCN.

config SIPA_TEST
	bool "Enable sipa test module"
	default n
	depends on SPRD_SIPA
	help
	  This option enables sipa test module.

config SPRD_IPA_PCIE_WORKROUND
	bool "Enable ipa pcie workround"
	default n
	depends on SPRD_SIPA
	help
	  This option enables sipa pcie workround.
          Orca ipa hardware limitations:
	  the sipc share memory must map from
	  0x280000000(orca side) to 0x80000000(roc1 side),
	  and the size must be 256M

endmenu
```

## drivers/staging/sprd/sipa_delegate/Kconfig
```kconfig
menu "SIPA delegate modules"
config SPRD_SIPA_DELEGATE
	bool "Enable delegate for modem side sipa"
	default n
	depends on SPRD_SIPA
	help
	  This option enables delegate for modem side sipa.

config SPRD_SIPA_DELE_MINIAP_IN_AP
	bool "Enable sipa delegate for mini ap in ap side"
	default n
	depends on SPRD_SIPA_DELEGATE
	help
	  This option enables a sipa delegate featrue in ap side.
	  And this option enables ap to create a delegatro for mini ap.

config SPRD_SIPA_DELE_AP_IN_MINIAP
	bool "Enable sipa delegate for ap in mini ap side"
	default n
	depends on SPRD_SIPA_DELEGATE
	help
	  This option enables a sipa delegate featrue in mini ap side.
	  And this option enables ap to create a delegatro for ap.

config SPRD_SIPA_DELE_CP_IN_MINIAP
	bool "Enable sipa delegate for cp in mini ap side"
	default n
	depends on SPRD_SIPA_DELEGATE
	help
	  This option enables a sipa delegate featrue in mini ap side.
	  And this option enables ap to create a delegatro for cp.
endmenu
```

## drivers/staging/sprd/sipa_sys/Kconfig
```kconfig
menu "Sipa System Modules"

config SPRD_IPA_SYS
	tristate "Spreadtrum Ipa Sys Power Management"
	default n
	select PM_GENERIC_DOMAINS if PM
	help
	  Sipa sys is a module that manages ipa low power.
	  When you select this feature, it will enable the pm generic
	  power domain for ipa_sys module.

endmenu
```

## fs/exfat/Kconfig
```kconfig
config EXFAT_FS
	tristate "EXFAT fs support"
	select NLS
	select NLS_UTF8
	help
	  If you want to use exfat file system, then you must say Y or M here
	  to include exFAT support. You will then be able to mount partitions or
	  diskettes with exFAT file systems and transparently access the
	  files on them.

config EXFAT_VIRTUAL_XATTR
	bool "Virtual xattr support for exFAT filesystem"
	default n
	depends on EXFAT_FS
	help
	  Modification of exFAT filesystem for virtual xattr

config EXFAT_VIRTUAL_XATTR_SELINUX_LABEL
	string "Default string for SELinux label"
	depends on EXFAT_FS && EXFAT_VIRTUAL_XATTR
	default "u:object_r:sdcard_external:s0"
	help
	  Set this to the default string for SELinux label.
```

## net/ims_bridge/Kconfig
```kconfig
#
# IMS Bridge configuration
#

config SPRD_IMS_BRIDGE
	tristate "Spreadtrum ims stack bridge support"
	depends on INET && NETFILTER && SPRD_SIPC
	default y
	help
	  This option adds ims stack bridge support to the kernel. We will
	  *route* the packets to the proper interface and ims stack, and
	  all of these are transparent to the ims stacks.
	  To compile it as a module, choose M here.  If unsure, say N.

config SPRD_IMS_BRIDGE_TEST
	bool "Spreadtrum ims stack bridge test suite feature"
	depends on SPRD_IMS_BRIDGE
	default y
	help
	  Support for ims bridge kernel test suite, the supported lists
	  can be retrived by /d/ims_bridge/test-suite.
	  If unsure, say N.
```
