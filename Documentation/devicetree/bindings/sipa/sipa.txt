## Documentation/devicetree/bindings/soc/sprd/sprd,powerdebug.txt
```
Unisoc power-debug bindings

This node is used to define the power and interrupt state. The power debug
driver will use this node to initialize power state structure and output debug
information into kernel log, which will help to analyze the SoC system power
exception.

Required properties:
- compatible: "sprd,power-debug".
		There will be IP for power debug used in Spreadtrum SoC families.
- sprd,sys-ap-ahb: Specify the ap-ahb address space node in the soc system
- sprd,ap-ahb-reg-tbl: define the register records which should be checked in
		the ap-ahb address space. each record includes three element:
		1) a register address offset in this address space
		2) a mask value which used to identified the required checked bit
		3) a 32 bits value which indicates the expected value if the reg_val
		& mask is not equal to the expected value, This driver will print
		these information into kernel log.
- sprd,sys-ap-apb: Specify the ap-apb address space node in the soc system
- sprd,ap-apb-reg-tbl: define the register records which should be checked in
		the ap-apb address space.
- sprd,sys-pmu-apb: Specify the pmu-apb address space node in the soc system
- sprd,pmu-apb-reg-tbl: define the register records which should be checked in
		the pmu-apb address space.
- sprd,sys-aon-apb: Specify the aon-apb address space node in the soc system
- sprd,aon-apb-reg-tbl: define the register records which should be checked in
		the aon-apb address space.
- sprd,sys-ap-intc: Specify a list in which every element expresses a INTC0
		controller's address space.
- sprd,ap-intc: define the sprd_ap_intcx list.
- sprd,pdm-name: define the sprd_pwr_statusx list.
- sprd_pwr_statusx: define the pwr_status node information, details refer to the
		following section-"subnode definattion" description.
- sprd_ap_intcx: define the ap_intc node information, details refer to the
		following section-"subnode definattion" description.

optional properties:
- sprd,sys-aon-sec: Specify the aon-sec address space node in the soc system
- sprd,aon-sec-reg-tbl: define the register records which should be checked in
		the aon-sec address space.

subnode definition:
1, sprd_pwr_statusx: describe a power state register
- reg: the register address offset in the pmu-apb address space.
- sprd,bit-width: define the bit width in the register of each power domain
- sprd,bit-index: a list, each element in it define the bit start offset in
		the register of the corresponding power domain
- sprd,pdm-names: a string list which includes some sub power domain names. if
		there is no definition to someone bits, uses "null" as
		its name. the element number of the list is
		[32 / pmu-state-bit-num].

2, sprd_ap_intcx: describe a interrupt state register
- reg: the register address offset in the INTC controller's address
		space
- sprd,int-names: a interrupt names list which includes 32 interrupts. if there is
		no interrupt to someone bit, uses "null" as its name.

Example:
power: power-debug {
		compatible = "sprd,power-debug";
		#address-cells = <1>;
		#size-cells = <0>;

		sprd,sys-ap-ahb = <&ap_ahb_regs>;

		/* <reg-addr mask expect-value> */
		sprd,ap-ahb-reg-tbl =
			<REG_AP_AHB_AHB_EB
			( MASK_AP_AHB_CKG_EB
			| MASK_AP_AHB_DMA_EB
			| MASK_AP_AHB_DMA_ENABLE
			| MASK_AP_AHB_VSP_EB
			| MASK_AP_AHB_DISPC_EB
			| MASK_AP_AHB_DSI_EB )
			MASK_AP_AHB_CKG_EB>,
			......
			<REG_AP_AHB_AP_ASYNC_BRG MASK_AP_AHB_AP_ASYNC_BRG_LP_EB MASK_AP_AHB_AP_ASYNC_BRG_LP_EB>;

		sprd,sys-ap-apb = <&ap_apb_regs>;

		sprd,ap-apb-reg-tbl =
			<REG_AP_APB_APB_EB
			( MASK_AP_APB_CE_PUB_EB
			| MASK_AP_APB_CE_SEC_EB
			| MASK_AP_APB_EMMC_EB
			| MASK_AP_APB_SDIO2_EB
			| MASK_AP_APB_SDIO1_EB
			| MASK_AP_APB_SDIO0_EB
			| MASK_AP_APB_UART2_EB
			| MASK_AP_APB_UART1_EB
			| MASK_AP_APB_UART0_EB
			| MASK_AP_APB_I2C4_EB
			| MASK_AP_APB_I2C3_EB
			| MASK_AP_APB_I2C2_EB
			| MASK_AP_APB_I2C1_EB
			| MASK_AP_APB_I2C0_EB
			| MASK_AP_APB_SPI3_EB
			| MASK_AP_APB_SPI2_EB
			| MASK_AP_APB_SPI1_EB
			| MASK_AP_APB_SPI0_EB
			| MASK_AP_APB_IIS2_EB
			| MASK_AP_APB_IIS1_EB
			| MASK_AP_APB_IIS0_EB
			| MASK_AP_APB_SIM0_EB )
			0x00000000>,
			REG_AP_APB_APB_MISC_CTRL
			( MASK_AP_APB_I2C4_SEC_EB
			| MASK_AP_APB_I2C3_SEC_EB
			| MASK_AP_APB_I2C2_SEC_EB
			| MASK_AP_APB_I2C1_SEC_EB
			| MASK_AP_APB_I2C0_SEC_EB
			| MASK_AP_APB_SPI3_SEC_EB
			| MASK_AP_APB_SPI2_SEC_EB
			| MASK_AP_APB_SPI1_SEC_EB
			| MASK_AP_APB_SPI0_SEC_EB )
			0x00000000>;

		sprd,sys-pmu-apb = <&pmu_apb_regs>;

		sprd,pmu-apb-reg-tbl =
			<REG_PMU_APB_PUB_SYS_AUTO_LIGHT_SLEEP_ENABLE MASK_PMU_APB_PUB_SYS_AUTO_LIGHT_SLEEP_ENABLE 0x00000000>,
			......
			<REG_PMU_APB_AXI_LP_CTRL_DISABLE MASK_PMU_APB_AXI_LP_CTRL_DISABLE MASK_PMU_APB_AXI_LP_CTRL_DISABLE>;

		sprd,sys-aon-apb = <&aon_apb_regs>;

		sprd,aon-apb-reg-tbl =
			<REG_AON_APB_APB_EB0
			( MASK_AON_APB_PROBE_EB
			| MASK_AON_APB_AUX1_EB )
			0x00000000>,
			......
			<REG_AON_APB_APCPU_DDR_AB_LPC_CTRL MASK_AON_APB_APCPU_DDR_AB_LP_EB 0x00000000>;

		sprd,sys-ap-intc = <&ap_intc0_regs &ap_intc1_regs
				&ap_intc2_regs &ap_intc3_regs
				&ap_intc4_regs &ap_intc5_regs>;

		sprd,ap-intc = <&sprd_ap_intc0 &sprd_ap_intc1 &sprd_ap_intc2
				&sprd_ap_intc3 &sprd_ap_intc4 &sprd_ap_intc5>;

		sprd,pdm-name = <&sprd_pwr_status0 &sprd_pwr_status1
				&sprd_pwr_status2 &sprd_pwr_status3
				&sprd_pwr_status4 &sprd_apcpu_pwr_state0
				&sprd_apcpu_pwr_state1>;

		sprd_pwr_status0: pwr-status@bc {
			reg = <REG_PMU_APB_PWR_STATUS0_DBG>;
			sprd,bit-width = <8>;
			sprd,bit-index = <0 8 16 24>;
			sprd,pdm-names = "PD_AP_SYS", "PD_AP_VSP",
				"null", "null";
		};
		......

		sprd_ap_intc0: ap-intc@0 {
			reg = <0x0000>;
			sprd,int-names = "null", "null", "AP_UART0", "AP_UART1",
				"AP_UART2", "AP_SPI0",	"AP_SPI1", "AP_SPI2",
				"AP_SPI3", "AP_SIM", "AP_EMMC",	"AP_I2C0",
				"AP_I2C1", "AP_I2C2", "AP_I2C3", "AP_I2C4",
				"AP_IIS0", "AP_IIS1", "AP_IIS2", "AP_SDIO0",
				"AP_SDIO1", "AP_SDIO2", "CE_SEC", "CE_PUB",
				"AP_DMA", "DMA_SEC_AP", "GSP", "DISPC",
				"SLV_FW_AP_INTERRUPT", "DSI_PLL", "DSI0",
				"DSI1";
		};
		......
	};
```

## Documentation/devicetree/bindings/soc/sprd/sprd,ptm.txt
```
Spreadtrum Performance Trace Monitor

Required properties:
- compatible: "sprd,sharkle-ptm".
	There will be different IP used in different Spreadtrum
	SoC families. So we use SoC name to compatible different SoC.
	e.g. sprd,sharkle-ptm(sharkle); sprd,sharkl3-ptm(sharkl3)
- reg: Address range of ptm and coresight registers.
- interrupts: Should contain the ptm interrupt number.
- clock-names: Coresight clock select names PTM used.
- clocks: Clock node ptm used.
- sprd,funnel-port: Define funnel port ptm used.
- sprd,ddr-chn: Number of channels supported by hardware.
- sprd,chn-name: Define all the channels name.

Example:
	ptm_trace: ptm@30040000 {
		compatible = "sprd,sharkle-ptm";
		reg = <0 0x30040000 0 0x10000>,
			<0 0x01001000 0 0x1000>,
			<0 0x01003000 0 0x1000>,
			<0 0x01004000 0 0x1000>;
		interrupts = <GIC_SPI 86 IRQ_TYPE_LEVEL_HIGH>;
		clock-names = "clk_cs", "cs_src";
		clocks = <&clk_cssys>, <&clk_twpll_96m>;
		sprd,funnel-port = <4>;
		sprd,ddr-chn = <7>;
		sprd,chn-name = "MM", "GPU", "DISP",
			"A53", "AP/VSP/GSP", "WTLCP/PUBCP",
			"WCN/AON";
	};
```

## Documentation/devicetree/bindings/soc/sprd/sprd,seth.txt
```
Spreadtrum seth bindings

This is only for virtual network interface controller that dealing with tcpip data transferring.

Required properties:
- compatible:
    - "sprd,seth": for network interface controller
    - "sprd,name": for name of nic
    - "sprd,dst": for id of destination
    - "sprd,channel": for id of channel
    - "sprd,blknum": for number of blocks
    - "sprd,poolsize": for the pool size of sipc
```

## Documentation/devicetree/bindings/soc/sprd/sprd,sipa_eth.txt
```
Unisoc sipa-eth bindings

This is only for virtual network interface controller that dealing with ipa data transferring.

Required properties:
- compatible: Must be "sprd,sipa_eth".
- sprd,netid: index for SIPA NIC interface
- sprd,term-type: names for the various IPA srouce / destination ID
- sprd,mac-header: a bool to indicate a skb has to pull its mac header or not

Example:

aliases {
	eth0 = &sipa_eth0;
	...
	eth8 = &sipa_eth8;
};

sipa_eth8:  sipa-wifi {
	compatible = "sprd,sipa_eth";
	sprd,netid = <0>;
	sprd,term-type = <0x2>;
};

On Roc1+Orca platform:
sipa_eth0: sipa-eth0 {
	compatible = "sprd,sipa_eth";
	sprd,netid = <1>;
	sprd,term-type = <0x6>;
};

On Orca CPE platform:
sipa_eth0: sipa-eth0 {
	compatible = "sprd,sipa_eth";
	sprd,netid = <1>;
	sprd,term-type = <0x6>;
	sprd,mac-header;
};
```

## Documentation/devicetree/bindings/soc/sprd/sprd,sleep.txt
```
SPRD light sleep binding for pike2

Required properties:

- compatible: must be "sprd,pike2-sleep".
- sprd,sys-ap-ahb: ap ahb controller.
- sprd,sys-ap-apb: ap apb controller.
- sprd,sys-aon-apb: aon apb controller.
- sprd,sys-pmu-apb: aon pmu controller.
- sprd,sys-ap-intc0: ap interrupt controller0.
- sprd,sys-ap-intc1: ap interrupt controller1.
- sprd,sys-ap-intc2: ap interrupt controller2.
- sprd,sys-ap-intc3: ap interrupt controller3.

Example:

	sprd-sleep {
		compatible = "sprd,pike2-sleep";
		sprd,sys-ap-ahb = <&ap_ahb_regs>;
		sprd,sys-ap-apb = <&ap_apb_regs>;
		sprd,sys-aon-apb = <&aon_apb_regs>;
		sprd,sys-pmu-apb = <&pmu_apb_regs>;
		sprd,sys-ap-intc0 = <&intc0_controller>;
		sprd,sys-ap-intc1 = <&intc1_controller>;
		sprd,sys-ap-intc2 = <&intc2_controller>;
		sprd,sys-ap-intc3 = <&intc3_controller>;
	};
```

## Documentation/devicetree/bindings/sound/sprd-asoc-machine.txt
```
* Spreadtrum asoc machine driver of i2s

This node models the spreadtrum ASoC machine driver

Required properties:
- compatible		: "sprd,i2s-null-codec", "sprd,vbc-r3p0-codec-sc2731",
				"sprd,vbc-r1p0v3-codec-sc2721", "sprd,vbc-r1p0v3-codec-sc2731",
				"sprd,vbc-r2p0-codec-sc2723", "sprd,vbc-v4-codec-sc2730"
- sprd-audio-card,name : card name
- sprd-audio-card,widgets : simple widigets of the card
- sprd-audio-card,routing :
	A list of the connections between audio components.
	Each entry is a pair of strings, the first being the
	connection's sink, the second being the connection's
	source.
- sprd-audio-card,headset : reference node of sprd_headset

Dai-link subnode properties and subnodes:

Required dai-link subnodes:

- cpu					: CPU   sub-node
- codec					: CODEC sub-node
- plat					: PLATFORM sub-node

Required CPU/CODEC subnodes properties:
-sound-dai		: phandle/s and port of CPU/CODEC

Example:
sound_vbc_v4_sprd_codec: sound@0 {
	compatible = "sprd,vbc-v4-codec-sc2730";
	sprd-audio-card,name = "sprdphone-sc2730";
	sprd-audio-card,widgets =
		"Headphone", "inter HP PA",
		"Speaker", "inter Spk PA",
		"Speaker", "inter Ear PA";
	sprd-audio-card,routing =
		"HPMIC", "HPMIC Pin",
		"MIC", "MIC Pin",
		"AUXMIC", "MIC2 Pin",
		"inter HP PA", "HP Pin",
		"inter Spk PA", "SPK Pin",
		"inter Ear PA", "EAR Pin";
	sprd,ucp-smart-pa;
	sprd-audio-card,headset = <&sprd_headset>;
	sprd-audio-card,dai-link@0 {
		link-name = "FE_NORMAL_AP01";
		stream-name = "FE_ST_NORMAL_AP01";
		ignore-suspend = <0>;
		dynamic = <1>;
		trigger = <1 1>;
		dpcm-playback = <1>;
		dpcm-capture = <1>;
		be-id = <0>;
		plat {
			sound-dai = <&sprd_pcm>;
		};
		cpu {
			sound-dai = <&sprd_fe_dai 0>;
		};
		codec {
			sound-dai = <0 0>;
		};
	};
}
```

## Documentation/devicetree/bindings/sound/sprd-audcp-access.txt
```
* Spreadtrum sound audio co-processor access driver

This node models spreadtrum sound audio co-processor access driver

Required properties:

- compatible	: "sprd,agdsp-access"
- sprd,syscon-agcp-ahb : node of audio co-processor ahb
- sprd,syscon-pmu-apb : node of pmu apb
- syscons : control function for access audio co-processor.
- syscon-names : names of used syscons function
- sprd,dst : comunicate target id of audio co-processor.
- sprd,channel : communicate channel,
	which is used only for ap access audio co-processor.
	And channel number 130 is negotiated by application processor
	and audio co-processor.
- sprd,sipc-name : name of audio communicate module
- sprd,mailbox-core : mailbox core for audio co-processor.
- sprd,ddr-addr-offset : ddr address mapping offset between ap and
	audio co-processor.
- hwlocks : hardware lock for muti co-processor.
- sprd,auto_agcp_access : switch of agcp auto access

Example:
agdsp-access {
	compatible = "sprd,agdsp-access";
	sprd,syscon-agcp-ahb = <&aon_apb_regs>;
	sprd,syscon-pmu-apb = <&pmu_apb_regs>;
	syscons = <&pmu_apb_regs REG_PMU_APB_SLEEP_CTRL   MASK_PMU_APB_AUDCP_DEEP_SLEEP>,
			<&pmu_apb_regs REG_PMU_APB_SLEEP_STATUS   MASK_PMU_APB_AUDCP_SLP_STATUS>,
			<&pmu_apb_regs REG_PMU_APB_PWR_STATUS4_DBG   MASK_PMU_APB_PD_AUDCP_SYS_STATE>,
			<&pmu_apb_regs REG_PMU_APB_PWR_STATUS3_DBG   MASK_PMU_APB_PD_AUDCP_AUDDSP_STATE>,
			<&aon_apb_regs REG_AON_APB_AUDCP_CTRL  MASK_AON_APB_AP_2_AUD_ACCESS_EN>;
	syscon-names = "audcp_pmu_sleep_ctrl", "audcp_pmu_slp_status",
		       "audcp_pmu_pwr_status4", "audcp_pmu_pwr_status3",
		       "ap_access_ena";
	sprd,dst = <5>;
	sprd,channel = <130>;
	sprd,sipc-name = "sipc0";
	sprd,mailbox-core = <5>; /* AGDSP id */
	sprd,ddr-addr-offset = <0x0>;
	hwlocks = <&hwlock 11>;
	sprd,auto_agcp_access = <0>;
};
```

## Documentation/devicetree/bindings/sound/sprd-audcp-boot.txt
```
* Spreadtrum audio cp boot

This node models spreadtrum audio cp boot function from kernel.

Required properties:

- compatible : "sprd,sharkl5-audcp-boot", "sprd,roc1-audcp-boot",
	"sprd,orca-audcp-boot","sprd,sharkl5pro-audcp-boot"
- syscons : Pmu and aon registers used for audio cp boot.
- syscon-names : The function name for dsp boot registers.

Example:
audiocp_boot {
	compatible = "sprd, sharkl5-audcp-boot";
	syscons =
		<&pmu_apb_regs REG_PMU_APB_PD_AUDCP_SYS_CFG
		MASK_PMU_APB_PD_AUDCP_SYS_FORCE_SHUTDOWN>,
		<&pmu_apb_regs REG_PMU_APB_PD_AUDCP_AUDDSP_CFG
		MASK_PMU_APB_PD_AUDCP_AUDDSP_AUTO_SHUTDOWN_EN>,
		<&pmu_apb_regs REG_PMU_APB_SLEEP_CTRL
		MASK_PMU_APB_AUDCP_FORCE_DEEP_SLEEP>,
		<&pmu_apb_regs REG_PMU_APB_CP_SOFT_RST
		MASK_PMU_APB_AUDCP_AUDDSP_SOFT_RST>,
		<&pmu_apb_regs REG_PMU_APB_CP_SOFT_RST
		MASK_PMU_APB_AUDCP_SYS_SOFT_RST>,
		<&pmu_apb_regs REG_PMU_APB_SOFT_RST_SEL
		MASK_PMU_APB_SOFT_RST_SEL>,
		<&pmu_apb_regs REG_PMU_APB_PWR_STATUS4_DBG
		MASK_PMU_APB_PD_AUDCP_SYS_STATE>,
		<&pmu_apb_regs REG_PMU_APB_PWR_STATUS3_DBG
		MASK_PMU_APB_PD_AUDCP_AUDDSP_STATE>,
		<&pmu_apb_regs REG_PMU_APB_SLEEP_STATUS
		MASK_PMU_APB_AUDCP_SLP_STATUS>,
		<&aon_apb_regs REG_AON_APB_AUDCP_BOOT_PROT
		MASK_AON_APB_REG_PROT_VAL>,
		<&aon_apb_regs REG_AON_APB_AUDCP_DSP_CTRL0
		MASK_AON_APB_AUDCP_DSP_BOOT_VECTOR>,
		<&aon_apb_regs REG_AON_APB_AUDCP_DSP_CTRL1
		MASK_AON_APB_AUDCP_DSP_BOOT>;
	syscon-names = "sysshutdown", "coreshutdown", "deepsleep", "corereset",
		"sysreset", "reset_sel", "sysstatus", "corestatus", "sleepstatus",
		"bootprotect", "bootvector", "bootaddress_sel";
};
```

## Documentation/devicetree/bindings/sound/sprd-audcp-dump.txt
```
* Spreadtrum sound audio cp dump driver

This node models spreadtrum sound audio cp dump driver

Required properties:
- compatible : "sprd,audio_dsp_log", "sprd,audio_dsp_mem"
	"sprd,audio_dsp_pcm"
- sprd-usemem-type : allocated memory block id for dump
- sprd-dst : communicate target, should be 1 for audio cp
- sprd-channel : communicate channel id, negotiate with dsp
- sprd-rxblocknum : share memory is divided several blocks.
	and sprd-rxblocknum is defined the block counts.
- sprd-rxblocksiz: eshare memory is divided several blocks.
	and sprd-rxblocknum is defined the size of one block.

Example:
audio-dsp-dump@0 {
	compatible = "sprd,audio_dsp_log";
	sprd-usemem-type =<0x5>;
	sprd-dst = /bits/ 8 <1>;
	sprd-channel =/bits/ 8 <4>;
	sprd-rxblocknum=<0x8>;
	sprd-rxblocksize=<0x2000>;
};
```
