## Documentation/devicetree/bindings/soc/sprd/sprd,cpdvfs.txt
```
Unisoc cpdvfs bindings

Unisoc's some SoCs integrates hardware DVFS. This DVFS driver controls settings and tuning
for communication processor include pubcp and wtlcp.

Required Properties:
- compatible: should be one of the following.
  - "sprd,sharkl5-pubcp-dvfs": for Sharkl5-compatible PUBCP DVFS,
  - "sprd,sharkl5-wtlcp-dvfs": for Sharkl5-compatible WTLCP DVFS,
  - "sprd,roc1-pubcp-dvfs": for Roc1-compatible PUBCP DVFS,
  - "sprd,roc1-wtlcp-dvfs": for Roc1-compatible WTLCP DVFS,
  - "sprd,sharkl5Pro-pubcp-dvfs": for Sharkl5Pro-compatible PUBCP DVFS,
  - "sprd,sharkl5Pro-wtlcp-dvfs": for Sharkl5Pro-compatible WTLCP DVFS.

- sprd,core_id : core identification of the dvfs processor.

- sprd,record_num: number of dvfs running recorder.


Example:
	dvfs_pubcp {
		compatible = "sprd,sharkl5-pubcp-dvfs";
		sprd,core_id = <0>;
		sprd,record_num = <10>;
	};

	dvfs_wtlcp {
		compatible = "sprd,sharkl5-wtlcp-dvfs";
		sprd,core_id = <1>;
		sprd,record_num = <6>;
	};
```

## Documentation/devicetree/bindings/soc/sprd/sprd,djtag.txt
```
Spreadtrum DJTAG

== Introduction ==
The main functions of djtag are to configure the busmonitor, configure
the system performance related registers, and view the debug registers
of bus status. As the above hardware design, the software design a model,
according to the function of the division. Each function is viewed as
a slave device with an independent drive, and DJTAG is regarded as the
master bus, and all the devices connect to it.the slave device config
parameters by DJTAG bus. The slave devices and the master djtag dts how
to config as below.

For example:
djtag: djtag@40340000 {
	compatible  = "sprd,djtag";
	...
	aon@0{
		...
	}

	ap@1{
		...
	}

	mm@2{
		...
	}
};

Required properties:
- compatible: Must be "sprd,djtag".
- reg: Address range of djtag registers.
- reg-names: Must be "glb" and "djtag". reg-names is fixed in DJTAG driver,
	it will determine the order of reg address. The DJTAG driver will
	find the corresponding address in the order of the fixed string.
- clock-names: Must be "enable", It is a name that the correspond clocks property.
- clocks: Should contain djtag enable bits.
- hwlocks: Should contain all HWspinlock of the DJTAG module using.
- hwlock-names: Should contain all HWspinlock names of the DJTAG module using.
- #address-cells: number of cells required to define a sys module address
	on the DJTAG bus. Should be set to 1.
- #size-cells: size of cells required to define a sys module address size on
	the DJTAG bus, should be set to 0.

Example:

djtag: djtag@40340000 {
	compatible  = "sprd,djtag";
	reg = <0x40340000 0x1000>,
		<0x402e0000 0x10000>;
	reg-names = "djtag", "glb";
	clock-names = "enable";
	clocks = <&clk_aon_apb_gates1 20>;
	hwlocks = <&hwslock1 10>;
	hwlock-names = "djtag";
	#address-cells = <1>;
	#size-cells = <0>;
};
```

## Documentation/devicetree/bindings/soc/sprd/sprd,dmc-mpu-r3p0.txt
```
Spreadtrum DMC MPU

Required properties:
- compatible: "sprd,dmc-mpu-r3p0".
	There will be different IP versions for different Spreadtrum
	SoC families. So we use specified IP to compatible different SoC.
	e.g. sprd,dmc-mpu-r3p0 for pike2.
- reg: Address range of dmc mpu registers.
- sprd,ddr-interleaved: Used to indicate whether the DDR is interleaved.
- interrupts: Should contain the bus-monitor interrupt number.
- sprd,channel-num: Should contain DDR hardware channel number.
- sprd,channel-names: Should contain the name of each DDR hardware channel.
- sprd,ranges: Should contain DMC MPU monitored range address each channel.
- sprd,chn-config: Should contain enable channel, monitor range and monitor mode.
- sprd,id-config: Should contain DMC MPU monitored ID type, master ID and mask bits.
- sprd,panic: Used to indicate whether panic when occurred the address violate event
- sprd,shared-chn: Should contain the channel name which used for shared.
- sprd,ddr-offset: The value is the offset of the AXI accessing address to
		the DDR hardware address
- status: Used to indicate whether open the MPU device.

Configuration related macro definitions:
/*MPU property*/
#define ENABLE		1
#define DISABLE		0
#define MON_WRITE	1
#define MON_READ	2
#define MON_WRITEREAD	(MON_WRITE | MON_READ)
#define MON_OUTSIDE	0
#define MON_INSIDE	1

/*ID property*/
#define USERID	1
#define MPUID	0

Example:

	dmc-mpu@300e0000 {
		compatible = "sprd,dmc-mpu-r3p0";
		reg = <0 0x300e0000 0 0x10000>;
		interrupts = <GIC_SPI 61 IRQ_TYPE_LEVEL_HIGH>;
		sprd,channel-num = <8>;
		sprd,channel-names = "MM", "GPU", "DISP",
				"A53", "AP/VSP/GSP", "WTLCP/PUBCP",
				"WCN/AON", "SHARED";
		sprd,ranges = <0 0>,
			<0 0>,
			<0 0>,
			<0X90000000 0X90001000>,
			<0 0>,
			<0x89600000 0x8EE00000>,
			<0 0>,
			<0X90001000 0X90002000>;
		sprd,chn-config =
				<DISABLE MON_INSIDE MON_WRITE>,
				<DISABLE MON_INSIDE MON_WRITE>,
				<DISABLE MON_INSIDE MON_WRITE>,
				<ENABLE MON_INSIDE MON_WRITE>,
				<ENABLE MON_INSIDE MON_WRITE>,
				<DISABLE MON_INSIDE MON_WRITE>,
				<DISABLE MON_INSIDE MON_WRITE>,
				<ENABLE MON_INSIDE MON_WRITE>;
		sprd,id-config =
				<MPUID 0 0>, <MPUID 0 0>,
				<MPUID 0 0>, <MPUID 0 0>,
				<MPUID 0 0>, <MPUID 0 0>,
				<MPUID 0 0>, <USERID 0 0>;
		sprd,panic;
		sprd,ddr-interleaved;
		sprd,shared-chn = "A53";
		sprd,ddr-offset = <0x80000000>;
		status = "disable";
	};
```

## Documentation/devicetree/bindings/soc/sprd/sprd,dmc-mpu.txt
```
Spreadtrum DMC MPU

Required properties:
- compatible: "sprd,sharkl3-dmc-mpu", "sprd,sharkl5-dmc-mpu", "sprd,sharkl5pro-dmc-mpu".
	There will be different IP versions for different Spreadtrum
	SoC families. So we use specified IP to compatible different SoC.
	e.g. sprd,dmc-mpu-r4p0 for SHARKL3.
- reg: Address range of dmc mpu registers.
- syscon-names: Should contain following entries:
	"irq_clr" for clear MPU irq.
	"irq_enable" for enable MPU irq.
- syscons: Should contain the base address, offset and bit for each entry in syscon-names.
- sprd,ddr-interleaved: Used to indicate whether the DDR is interleaved.
- interrupts: Should contain the bus-monitor interrupt number.
- sprd,channel-num: Should contain DDR hardware channel number.
- sprd,mpu-num: Should contain MPU module number.
- sprd,channel-names: Should contain the name of each DDR hardware channel.
- sprd,ranges: Should contain DMC MPU monitored range address each channel.
- sprd,chn-config: Should contain enable channel, monitor range and monitor mode.
- sprd,id-config: Should contain DMC MPU monitored ID type, master ID and mask bits.
- sprd,panic: Used to indicate whether panic when occurred the address violate event
- sprd,shared-chn: Should contain the channel name which used for shared.
- sprd,port-map: Should contain the mapping table from the MPU channel to
	the DDR channel.
- sprd,ddr-offset: The value is the offset of the AXI accessing address to
	the DDR hardware address
- status: Used to indicate whether open the MPU device.

Configuration related macro definitions:
/*MPU property*/
#define ENABLE		1
#define DISABLE		0
#define MON_WRITE	1
#define MON_READ	2
#define MON_WRITEREAD	(MON_WRITE | MON_READ)
#define MON_OUTSIDE	0
#define MON_INSIDE	1

/*ID property*/
#define USERID	1
#define MPUID	0

Example:

dmc_mpu: dmc-mpu@300e0000 {
	compatible = ""sprd,sharkl5-dmc-mpu";
	reg = <0 0x300e0000 0 0x20000>;
	interrupts = <GIC_SPI 61 IRQ_TYPE_LEVEL_HIGH>;
	syscon-names = "irq_clr", "irq_en";
	syscons = <&pub_apb_regs REG_PUB_APB_PUB_INT_CTRL
		MASK_PUB_APB_DMC_MPU_VIO_INT_CLR>,
		<&pub_apb_regs REG_PUB_APB_PUB_INT_CTRL
		MASK_PUB_APB_DMC_MPU_VIO_INT_EN>;
	sprd,channel-num = <8>;
	sprd,mpu-num = <16>;
	sprd,channel-names =
		"MM", "GPU", "DPU","CPU",
		"AP/PUBCP", "WTLCP", "AON/WCN/ETR",
		"VSP", "SHARED0", "SHARED1",
		"SHARED2","SHARED3", "SHARED4",
		"SHARED5","SHARED6", "SHARED7";
	sprd,ranges = <0 0>, <0 0>, <0 0>, <0 0>,
		<0 0>, <0 0>, <0 0>, <0 0>,
		<0 0>, <0 0>, <0 0>, <0 0>,
		<0 0>, <0 0>, <0 0>, <0 0>;
	sprd,chn-config =
		<DISABLE MON_INSIDE MON_WRITE>,
		<DISABLE MON_INSIDE MON_WRITE>,
		<DISABLE MON_INSIDE MON_WRITE>,
		<DISABLE MON_INSIDE MON_WRITE>,
		<DISABLE MON_INSIDE MON_WRITE>,
		<DISABLE MON_INSIDE MON_WRITE>,
		<DISABLE MON_INSIDE MON_WRITE>,
		<DISABLE MON_INSIDE MON_WRITE>,
		<DISABLE MON_INSIDE MON_WRITE>,
		<DISABLE MON_INSIDE MON_WRITE>,
		<DISABLE MON_INSIDE MON_WRITE>,
		<DISABLE MON_INSIDE MON_WRITE>,
		<DISABLE MON_INSIDE MON_WRITE>,
		<DISABLE MON_INSIDE MON_WRITE>,
		<DISABLE MON_INSIDE MON_WRITE>,
		<DISABLE MON_INSIDE MON_WRITE>;
	sprd,id-config =
			<MPUID 0 0>, <MPUID 0 0>,
			<MPUID 0 0>, <MPUID 0 0>,
			<MPUID 0 0>, <MPUID 0 0>,
			<MPUID 0 0>, <MPUID 0 0>,
			<MPUID 0 0>, <MPUID 0 0>,
			<MPUID 0 0>, <MPUID 0 0>,
			<MPUID 0 0>, <MPUID 0 0>,
			<MPUID 0 0>, <MPUID 0 0>;
	sprd,port-map = <0>, <1>, <2>, <3>, <4>,
			<5>, <6>, <7>, <0>, <0>,
			<0>, <0>, <0>, <0>, <0>,
			<0>;
	sprd,ddr-offset = <0x80000000>;
	sprd,panic;
	status = "disabled";
};
```

## Documentation/devicetree/bindings/soc/sprd/sprd,dmc.txt
```
Spreadtrum dmc driver interface
This binding follows the generic dmc bindings defined in sprd,dmc.txt.

Required properties:
- compatible: Maybe "sprd,sharkl5-dmc","sprd,roc1-dmc" or "sprd,sharkl3-dmc"
"sprd,pike2-dmc" or "sprd,sharkle-dmc".
- reg: Address range of ddr mode registers and pub monitor registers.

Example:
dmc_controller  {
	compatible = "sprd,sharkl5-dmc";
	reg = <0x0 0x31056200 0x0 0x1000>,
		<0x0 0x3000 0x0 0x1000>;
};
```

## Documentation/devicetree/bindings/soc/sprd/sprd,modem.txt
```
Spreadtrum modem bindings

Required properties:
- compatible: "sprd,modem", "sprd,pcie-modem".
	There will be different modem connection for different project
	"sprd,modem' is used for common soc chip, like sharkl2, sharkl3.
	"sprd,pcie-modem" is used for external modem that is connected
	with AP by pcie, like Roc1 + orca.
- syscon-names: Should contain following entries:
	"shutdowm" for modem shutdown/poweron.
	"deepsleep" for modem deepsleep enable/disable.
	"corereset" for modem core reset hold/release
	"sysreset" for modem system reset hold/release
	"getstatus" for get modem boot status
- syscons: Should contain the base address, offset and bit for each entry in syscon-names.
- 5g-modem-support: Used for support 5g modem.
- poweron-gpio: Used fo extenal modem poweron.
- reset-gpio: Used fo extenal modem reset.
- status: Used to indicate whether enable modem.

Example:

	sprd-modem {
		compatible = "simple-bus";
		ranges;

		lte_pm: modem@0 {
			compatible = "sprd,modem";
			syscons = <&aon_apb_regs 0xff 0x0>,
					<&pmu_apb_regs 0xff 0x100000>,
					<&aon_apb_regs 0x8c 0x1>,
					<&aon_apb_regs 0xff 0x0>,
					<&aon_apb_regs 0xff 0x0>;
			syscon-names = "shutdown", "deepsleep", "corereset",
					"sysreset", "getstatus";
		};

		lte_pubcp: modem@1 {
			compatible = "sprd,modem";
			syscons = <&pmu_apb_regs 0x58 0x2000000>,
				<&pmu_apb_regs 0x544 0x8>,
				<&aon_apb_regs 0x174 0x400>,
				<&pmu_apb_regs 0xb0 0x2>,
				<&aon_apb_regs 0xff 0x0>;
			syscon-names = "shutdown", "deepsleep", "corereset",
					"sysreset", "getstatus";
		};

		nr_dp: modem@1 {
			compatible = "sprd,pcie-modem";
			5g-modem-support;
		};

		nr_pscp: modem@2 {
			compatible = "sprd,pcie-modem";
			5g-modem-support;
		};
	};
```

## Documentation/devicetree/bindings/soc/sprd/sprd,modem_ctrl.txt
```
Spreadtrum mcd bindings

Required properties:
- compatible: Should be one of the following:
  "sprd,roc1-modem-ctrl",
  "sprd,orca-modem-ctrl".
- poweron-gpio: control modem power.
- reset-gpio: control modem reset.
- cpwatchdog-gpio: modem watchdog reset int. It should be set as input and high level trigger for AP
  subsystem, and set as output and high level trigger for CP subsystem as defaut configuration.
- cpassert-gpio: modem assert int. Its default configuration should be same as cpwatchdog-gpio.
- cppanic-gpio: modem panic int. Its default configuration should be same as cpwatchdog-gpio.
- cppoweroff-gpio: let modem poweroff int. Its default configuration should be same as cpwatchdog-gpio.
Example:

	sprd-mcd {
		compatible = "sprd,roc1-modem-ctrl";
		poweron-gpio = <&ap_gpio 15 GPIO_ACTIVE_LOW>;
		reset-gpio = <&ap_gpio 16 GPIO_ACTIVE_LOW>;
		cpwatchdog-gpio = <&ap_gpio 30 GPIO_ACTIVE_LOW>;
		cpassert-gpio = <&ap_gpio 36 GPIO_ACTIVE_LOW>;
		cppanic-gpio = <&ap_gpio 31 GPIO_ACTIVE_LOW>;
		cppoweroff-gpio = <&ap_gpio 33 GPIO_ACTIVE_HIGH>;
	};
```
