## Documentation/devicetree/bindings/leds/backlight/ktd3137_bl.txt
```
KTD3137-backlight bindings

Required properties:
- compatible			: Must be "sprd,ktd3137"

Optional properties:
- hwen-gpio			: hwen gpio
- ktd,using-lsb			: switch max brightness
- ktd,using-linear		: switch update value
- ktd,bl-fscal-led		: default 20.2mA
- ktd,turn-on-ramp		: please check datasheet
- ktd,turn-off-ramp		: please check datasheet
- ktd,i2c-trans-dim		: please check datasheet
- ktd,bl-channel		: switch blacklight channel
- ktd,ovp-level			: default 32v
- ktd,inductor-current		: dfault 2600mA
- ktd,switching-frequency	: dfault 1000KHz

Example:

	ktd3137_backlight: sprd_backlight {
		status = "okay";
		compatible = "sprd,ktd3137";
		reg = <0x36>;
		hwen-gpio = <&ap_gpio 133 GPIO_ACTIVE_HIGH>;
		ktd,using-lsb;
		ktd,using-linear;
		ktd,bl-fscal-led = <0x99>;
		ktd,turn-on-ramp = <0>;
		ktd,turn-off-ramp = <0>;
		ktd,i2c-trans-dim = <0>;
		ktd,bl-channel = <2>;
		ktd,ovp-level = <32>;
		ktd,inductor-current = <1800>;
		ktd,switching-frequency = <1000>;
	};
```

## Documentation/devicetree/bindings/mfd/sc2703.txt
```
Spreadtrum Communications SC2703 Charger block MFD bindings

SC2703 is a high voltage, high current charger with built-in ADC GPIO and
Flash-led functionality.

======

Required properties:
- compatible : Should be "sprd,sc2703"
- reg: I2C slave address, 0x4C.
- interrupt-parent : Specifies the phandle of the interrupt controller to which
  the IRQs from SC2703 are delivered to.
- interrupts : IRQ line info for sc2703.
- interrupt-controller: sc2703 has internal IRQs (own IRQ domain).
  (See ../interrupt-controller/interrupts.txt for further info)

======

Child nodes:

- sc2703-adc: See ../iio/adc/sc2703-adc.txt
- sc2703-charger: See ../power_supply/sc2703-charger.txt
- gpio-sc2703: See ../gpio/gpio-sc2703.txt

======

Example:

	sc2703_pmic: pmic@4C {
		compatible = "sprd,sc2703";
		reg = <0x4c>;
		interrupt-parent = <&gpio6>;
		interrupts = <11 IRQ_TYPE_LEVEL_LOW>;
		interrupt-controller;

		adc: sc2703-adc {
			compatible = "sprd,sc2703-adc";
			#io-channel-cells = <1>;
		};

		gpio: sc2703-gpio {
			compatible = "sprd,sc2703-gpio";
			#gpio-cells = <2>;
			gpio-controller;
		};

		sc2703-charger {
			compatible = "sprd,sc2703-charger";
		};
	};
```

## Documentation/devicetree/bindings/mfd/syscon.txt
```
* System Controller Registers R/W driver

System controller node represents a register region containing a set
of miscellaneous registers. The registers are not cohesive enough to
represent as any specific type of device. The typical use-case is for
some other node's driver, or platform-specific code, to acquire a
reference to the syscon node (e.g. by phandle, node path, or search
using a specific compatible value), interrogate the node (or associated
OS driver) to determine the location of the registers, and access the
registers directly.

Required properties:
- compatible: Should contain "syscon".
- reg: the register region can be accessed from syscon

Optional property:
- reg-io-width: the size (in bytes) of the IO accesses that should be
  performed on the device.
- hwlocks: reference to a phandle of a hardware spinlock provider node.
- #syscon-cells:   Represents the number of args. Used when syscon-names
  is going to be used. The value is vendor specific.

Examples:
gpr: iomuxc-gpr@020e0000 {
	compatible = "fsl,imx6q-iomuxc-gpr", "syscon";
	reg = <0x020e0000 0x38>;
	hwlocks = <&hwlock1 1>;
};

hwlock1: hwspinlock@40500000 {
	...
	reg = <0x40500000 0x1000>;
	#hwlock-cells = <1>;
};


==Syscon names==

Refer to syscon node by names with phandle args in syscon consumer node.

Required properties:
- syscons:	List of phandle and any number of args. Args is specific to
		differnet vendor. For example: In Spreatrum SoCs, the 1st arg
		will be treated as register address offset and the 2nd is bit
		mask as default.

- syscon-names:	List of syscon node name strings sorted in the same
		order as the syscons property.

Optional properties:

- syscon-ranges:	/*TODO*/


For example:

apb_regs: syscon@20008000 {
	compatible = "sprd,apb-glb", "syscon";
	#syscon-cells = <2>;
	reg = <0x20008000 0x100>;
};

aon_regs: syscon@40008000 {
	compatible = "sprd,aon-glb", "syscon";
	#syscon-cells = <1>;
	reg = <0x40008000 0x100>;
};

display@40500000 {
	...
	syscons = <&ap_apb_regs 0x4 0xf00>, <&aon_regs 0x8>;
	syscon-names = "enable", "power";
};
```
