## Documentation/devicetree/bindings/cpufreq/cpufreq-sprd.txt
```
DT binding for Spreadtrum cpufreq driver
========================================

It supports uniprocessor (UP), traditional symmetric multiprocessor (SMP) systems, and DSU
multi-core systems.

Required properties:
- #address-cells: number of cells to encode an address.
- #size-cells: number of cells representing the size of an address.
- cpuX - node contain the particular cpu information.
	- device_type: it must be set to "cpu".
	- compatible: discribe ARM version in APSYS, it could be one of the following,
			"arm,cortex-a7";
			"arm,cortex-a53";
			"arm,cortex-a55";
			"arm,cortex-a75";
	- reg: physical base address and length of the registers set for the device.
	- operating-points: Table of frequencies and voltage CPU could be transitioned into,
		in the decreasing order. Frequency should be in KHz units and voltage
		should be in microvolts.
	- cpu-supply: A phandle to the power supply regulator for this cpu.
		This is mandatory for cpu0.
	- cpufreq-data: A phandle to sprd-cpufreq driver related data. This contains information
		about clocks, voltage tolerance etc.
	- sprd,efuse-blk-binning: cpu binning block num and valuable bits
		for example,<6 0x3c00> means cpu binning block num is 6 and 0x3c indicates
		valuable bits are bit10 bit11 bit12 bit13.

- cpufreq-clusX - node contain the properties for sprd cpufreq driver for X cluster.
	- clocks: A phandle to the clock refered in clock-names for this cpu.
	- clock-names: Names of the clocks as shown bellow -
		- core_clk: mcu clock of this cpu.
		- high_freq_clk_parent - high frequency clock parent that can be used by core_clk.

Optional properties:
- cpufreq-clusX node.
	- clock-names: Names of the optional clock parents as shown bellow -
		- low_freq_clk_parent - Lower frequency clock parent that can be used by core_clk.
	- clock-latency: Specify the possible maximum transition latency for clock,
		in unit of nanoseconds.
	- voltage-tolerance: Specify the CPU voltage tolerance in percentage.
	- dual-phase-supply - boolean flag used only if SOC have shared power supply for Big and
		Little clusters, and we are not defining cpu-supply for this cpu.
	-sprd,multi-version: A boolean property to illustrate whether there are multi-version of the same SOC.
	-sprd,cpu-gpu-share-volt: A boolean property to illustrate whether cpu and gpu share the same vdd domain.

- sprd_swdvfs node.
	- compatible: Describe which soc will use swdvfs driver,for example:
			"sprd,sharkl3-swdvfs";

Example 1: Example for quad core, single cluster architecture.
--------
	cpus {
		#address-cells = <1>;
		#size-cells = <0>;

		cpu0: cpu@f00 {
			device_type = "cpu";
			compatible = "arm,cortex-a7";
			enable-method = "sprd,sc9830-smp";
			reg = <0xf00>;
			operating-points = <
				/* kHz  uV */
				1000000 950000
				900000  950000
				768000  950000>;
			cpu-supply = <&vddarm>;
			cpufreq-data = <&cpufreq_clus0>;
			sprd,efuse-blk-binning= <6 0x3c00>;
		};

		cpu1: cpu@f01 {
			device_type = "cpu";
			compatible = "arm,cortex-a7";
			reg = <0xf01>;
		};

		cpu2: cpu@f02 {
			device_type = "cpu";
			compatible = "arm,cortex-a7";
			reg = <0xf02>;
		};

		cpu3: cpu@f03 {
			device_type = "cpu";
			compatible = "arm,cortex-a7";
			reg = <0xf03>;
		};
	};

	cpufreq_clus0: cpufreq-clus0 {
		clocks = <&clk_mcu>,
			<&clk_twpll_768m>,
			<&clk_mpll>;
		clock-names = "core_clk",
			"low_freq_clk_parent",
			"high_freq_clk_parent";
		clock-latency = <50000>;
		voltage-tolerance = <0>;
	};

Example 2: Example for Big-Little architecture having shared power supply for Big and Little clusters.
---------
    cpus {
		#address-cells = <2>;
		#size-cells = <0>;
		..
		..
		CPU0: cpu@530000 {
			device_type = "cpu";
			compatible = "arm,cortex-a53", "arm,armv8";
			reg = <0x0 0x530000>;
			enable-method = "psci";
			operating-points = <
				/* kHz  uV */
				1200000 850000
				900000  820000
				768000  800000>;
			cpu-supply = <&vddarm0>;
			cpufreq-data = <&cpufreq_clus0>;
		};
		CPU1: cpu@530001 {
			device_type = "cpu";
			compatible = "arm,cortex-a53", "arm,armv8";
			reg = <0x0 0x530001>;
			enable-method = "psci";
			operating-points = <
				/* kHz  uV */
				1200000 850000
				900000  820000
				768000  800000>;
			cpu-supply = <&vddarm0>;
			cpufreq-data = <&cpufreq_clus0>;
		};
		..
		..
		CPU4: cpu@530100 {
			device_type = "cpu";
			compatible = "arm,cortex-a53", "arm,armv8";
			reg = <0x0 0x530100>;
			enable-method = "psci";
			operating-points = <
				/* kHz	uV */
				2100000	900000
				2000000	850000
				1700000	800000
				1536000	800000>;
			cpu-supply = <&vddarm0>;
			cpufreq-data = <&cpufreq_clus1>;
		};
		..
		..
	};

	cpufreq_clus0: cpufreq-clus0 {
		clocks = <&clk_lit_mcu>,
			<&clk_twpll_768m>,
			<&clk_mpll0>;
		clock-names = "core_clk",
			"low_freq_clk_parent",
			"high_freq_clk_parent";
		clock-latency = <50000>;
		voltage-tolerance = <0>;
		dual-phase-supply;
	};

	cpufreq_clus1: cpufreq-clus1 {
		compatible = "arm,cortex-a53", "arm,armv8";
		clocks = <&clk_big_mcu>,
			<&clk_twpll_768m>,
			<&clk_twpll>,
			<&clk_mpll1>;
		clock-names = "core_clk",
			"low_freq_clk_parent",
			"twpll_clk_parent",
			"high_freq_clk_parent";
		clock-latency = <50000>;
		voltage-tolerance = <0>;
		dual-phase-supply;
	};

Example 3: Example for Big-Little architecture having different power supply for Big and Little Clusters.
---------
    cpus {
		#address-cells = <2>;
		#size-cells = <0>;
		..
		..
		CPU0: cpu@530000 {
			device_type = "cpu";
			compatible = "arm,cortex-a53", "arm,armv8";
			reg = <0x0 0x530000>;
			enable-method = "psci";
			operating-points = <
				/* kHz  uV */
				1200000 850000
				900000  820000
				768000  800000>;
			cpu-supply = <&vddarm0>;
			cpufreq-data = <&cpufreq_clus0>;
		};
		CPU1: cpu@530001 {
			device_type = "cpu";
			compatible = "arm,cortex-a53", "arm,armv8";
			reg = <0x0 0x530001>;
			enable-method = "psci";
			operating-points = <
				/* kHz  uV */
				1200000 850000
				900000  820000
				768000  800000>;
			cpu-supply = <&vddarm0>;
			cpufreq-data = <&cpufreq_clus0>;
		};
		..
		..
		CPU4: cpu@530100 {
			device_type = "cpu";
			compatible = "arm,cortex-a53", "arm,armv8";
			reg = <0x0 0x530100>;
			enable-method = "psci";
			operating-points = <
				/* kHz	uV */
				2100000	900000
				2000000	850000
				1700000	800000
				1536000	800000>;
			cpu-supply = <&vddarm1>;
			cpufreq-data = <&cpufreq_clus1>;
		};
		..
		..
	};

	cpufreq_clus0: cpufreq-clus0 {
		clocks = <&clk_lit_mcu>,
			<&clk_twpll_768m>,
			<&clk_mpll0>;
		clock-names = "core_clk",
			"low_freq_clk_parent",
			"high_freq_clk_parent";
		clock-latency = <50000>;
		voltage-tolerance = <0>;
	};

	cpufreq_clus1: cpufreq-clus1 {
		compatible = "arm,cortex-a53", "arm,armv8";
		clocks = <&clk_big_mcu>,
			<&clk_twpll_768m>,
			<&clk_twpll>,
			<&clk_mpll1>;
		clock-names = "core_clk",
			"low_freq_clk_parent",
			"twpll_clk_parent",
			"high_freq_clk_parent";
		clock-latency = <50000>;
		voltage-tolerance = <0>;
	};

Example 4: Example for A specific soc will use swdvfs driver.
---------
	sprd_swdvfs: sprd-swdvfs {
		compatible = "sprd,sharkl3-swdvfs";
	};

Example 5: Example for A specific soc will be discerned of multi-version
---------
	cpufreq_clus0: cpufreq-clus0 {
		clocks = <&clk_lit_mcu>,
			<&clk_twpll_768m>,
			<&clk_mpll0>;
		clock-names = "core_clk",
			"low_freq_clk_parent",
			"high_freq_clk_parent";
		clock-latency = <50000>;
		voltage-tolerance = <0>;
		sprd,multi-version;
	};

Example 6: Example for a specific soc's cpu and gpu share the same vdd domain
	cpufreq_clus0: cpufreq-clus0 {
		clocks = <&clk_lit_mcu>,
			<&clk_twpll_768m>,
			<&clk_mpll0>;
		clock-names = "core_clk",
			"low_freq_clk_parent",
			"high_freq_clk_parent";
		sprd,cpu-gpu-share-volt;
	};
```

## Documentation/devicetree/bindings/display/sprd/backlight.txt
```
Spreadtrum backlight bindings

Required properties:
 - compatible: "sprd,sharkl5pro-backlight"
 - pwms: OF device-tree PWM specification (see PWM binding[0])
 - pwm-names: a list of names for the PWM devices specified in the
     "pwms" property (see PWM binding[0])
 - sprd,max-brightness-level: The max brightness level.
     Between min brightness level and max brightness level
     represents the actual brightness levels array
     (min brightness level defined by the "sprd,min-brightness-level" property)
 - default-brightness-level: the default brightness level.
     Must take a value between min brightness level and max brightness level
     see pwm-backlight binding[1]
 - sprd,brightness-scale: This value represents a 100% duty cycle (brightest)

Optional properties:
  - sprd,min-brightness-level: The min brightness level, default is 0.

[0]: Documentation/devicetree/bindings/pwm/pwm.txt
[1]: Documentation/devicetree/bindings/leds/backlight/pwm-backlight.txt

Example:

	backlight {
		compatible = "sprd,sharkl5pro-backlight";
		pwms = <&pwm 2 40000>;
		pwm-names = "backlight";
		sprd,max-brightness-level = <240>;
		default-brightness-level = <33>;
		sprd,brightness-scale = <255>;
	};
```

## Documentation/devicetree/bindings/display/sprd/dphy.txt
```
Spreadtrum MIPI DSI-PHY (D-PHY)
============================================================================

Required properties:
  - compatible: value should be "sprd,dsi-phy".
  - reg: must be the dsi controller base address.
  - #address-cells, #size-cells: should be set respectively to <1> and <0>
  - sprd,ip: the IP version of the D-PHY PLL module.
  - sprd,soc: the SoC family that contains this D-PHY hardware.

Video interfaces:
  Device node can contain video interface port nodes according to [1].
  The following are properties specific to those nodes:

  port node inbound:
    - reg: (required) must be 0.
  port node outbound:
    - reg: (required) must be 1.

  endpoint node connected from DSI controller node (reg = 0):
    - remote-endpoint: specifies the endpoint in DSI node.
  endpoint node connected to panel node (reg = 1):
    - remote-endpoint: specifies the endpoint in panel node.

[1]: Documentation/devicetree/bindings/media/video-interfaces.txt


Example:

	dphy: dphy {
		compatible = "sprd,dsi-phy";
		#address-cells = <1>;
		#size-cells = <0>;
		reg = <0x0 0x63100000 0x0 0x1000>;
		status = "disabled";

		sprd,ip = "sprd,megacores-sharkle";
		sprd,soc = "sharkl3";

		/* input port*/
		port@1 {
			reg = <1>;
			dphy_in: endpoint {
				remote-endpoint = <&dsi_out>;
			};
		};

		/* output port */
		port@0 {
			reg = <0>;
			dphy_out: endpoint {
				remote-endpoint = <&panel_in>;
			};
		};
	};
```

## Documentation/devicetree/bindings/display/sprd/dpu.txt
```
Spreadtrum SoC Display Processor Unit (DPU)
============================================================================

DPU (Display Processor Unit) is the Display Controller for the SPRD SoCs
which transfers the image data from a video memory buffer to an internal
LCD interface.

Required properties:
  - compatible: value should be "sprd,display-processor";
  - reg: physical base address and length of the DPU registers set.
  - interrupts: the interrupt signal from DPU.
  - clocks: must include clock specifiers corresponding to entries in the
	    clock-names property.
  - clock-names: list of clock names sorted in the same order as the clocks
                 property.
  - sprd,ip: the IP version of the DPU.
  - sprd,soc: the SoC family that contains this DPU hardware.
  - dma-coherent: with this property, the dpu driver can allocate large and
		  continuous memorys.
  - port: a port node with endpoint definitions as defined in document [1].

[1]: Documentation/devicetree/bindings/media/video-interfaces.txt.

Optional Properties:
  - iommus: a phandle to DPU iommu node.
  - power-domains: a phandle to DPU power domain node.


Example:

SoC specific DT entry:

	dpu: dpu@63000000 {
	        compatible = "sprd,display-processor";
	        reg = <0x0 0x63000000 0x0 0x1000>;
	        interrupts = <GIC_SPI 46 IRQ_TYPE_LEVEL_HIGH>;
		clock-names = "clk_src_128m",
				"clk_src_153m6",
				"clk_src_384m",
				"clk_dpu_core",
				"clk_dpu_dpi",
				"clk_aon_apb_disp_eb";

		clocks = <&clk_twpll_128m>,
			<&clk_twpll_153m6>,
			<&clk_twpll_384m>,
			<&clk_dpu>,
			<&clk_dpu_dpi>,
			<&clk_aon_top_gates 2>;
	        status = "disabled";

	        dma-coherent;

	        sprd,ip = "dpu-r2p0";
	        sprd,soc = "sharkl3";

	        dpu_port: port {
	                dpu_out: endpoint {
	                        remote-endpoint = <&dsi_in>;
	                };
	        };
	};


Board specific DT entry:

	&dpu {
		status = "okay";
	};
```

## Documentation/devicetree/bindings/display/sprd/drm.txt
```
Spreadtrum DRM master device
================================

The SPRD DRM master device is a virtual device needed to list all
DPU devices or other display interface nodes that comprise the
graphics subsystem.

Required properties:
- compatible: Should be "sprd,display-subsystem"
- ports: Should contain a list of phandles pointing to display interface port
  of DPU devices. DPU definitions as defined in
  Documentation/devicetree/bindings/display/sprd/dpu.txt

example:

display-subsystem {
	compatible = "sprd,display-subsystem";
	ports = <&dpu_out>;
};
```

## Documentation/devicetree/bindings/display/sprd/dsi.txt
```
Spreadtrum MIPI DSI Master
=============================================================================

Required properties:
  - compatible: value should be "sprd,dsi-host";
  - reg: physical base address and length of the registers set for the device
  - interrupts: should contain DSI interrupt
  - clocks: list of clock specifiers, must contain an entry for each required
	    entry in clock-names
  - clock-names: list of clock names sorted in the same order as the clocks
                 property.
  - #address-cells, #size-cells: should be set respectively to <1> and <0>
    according to DSI host bindings (see MIPI DSI bindings [1])
  - sprd,ip: the IP version of the DSI controller.
  - sprd,soc: the SoC family that contains this DSI hardware.

Optional properties:
  - power-domains: a phandle to DSIM power domain node

Child nodes:
  Should contain DSI peripheral nodes (see MIPI DSI bindings [1]).

Video interfaces:
  Device node can contain video interface port nodes according to [2].
  The following are properties specific to those nodes:

  port node inbound:
    - reg: (required) must be 0.
  port node outbound:
    - reg: (required) must be 1.

  endpoint node connected from DPU node (reg = 0):
    - remote-endpoint: specifies the endpoint in DPU node.
  endpoint node connected to D-PHY node (reg = 1):
    - remote-endpoint: specifies the endpoint in D-PHY node.

[1]: Documentation/devicetree/bindings/display/mipi-dsi-bus.txt
[2]: Documentation/devicetree/bindings/media/video-interfaces.txt

Example:

SoC specific DT entry:

	dsi: dsi@63100000 {
		compatible = "sprd,dsi-host";
		reg = <0 0x63100000 0 0x1000>;
		interrupts = <GIC_SPI 48 IRQ_TYPE_LEVEL_HIGH>,
			<GIC_SPI 49 IRQ_TYPE_LEVEL_HIGH>;
		clock-names = "clk_aon_apb_disp_eb";
		clocks = <&clk_aon_top_gates 2>;
		status = "disabled";

		sprd,ip = "sprd,dsi-ctrl", "r3p0";
		sprd,soc = "sharkl3";

		ports {
			#address-cells = <1>;
			#size-cells = <0>;

			port@0 {
				reg = <0>;
				dsi_in: endpoint {
					remote-endpoint = <&dpu_out>;
				};
			};

			port@1 {
				reg = <1>;
				dsi_out: endpoint@1 {
					remote-endpoint = <&dphy_in>;
				};
			};
		};
	};


Board specific DT entry:

	&dsi {
		status = "okay";
		#address-cells = <1>;
		#size-cells = <0>;

		panel {
			compatible = "sprd,generic-mipi-panel";
			#address-cells = <1>;
			#size-cells = <0>;
			reg = <0>;

			port {
				reg = <1>;
				panel_in: endpoint {
					remote-endpoint = <&dphy_out>;
				};
			};
		};
	};
```
