## Documentation/devicetree/bindings/display/sprd/dummy_connector.txt
```
Dummy Connector for Spreadtrum SoC
============================================================================

The dummy connector is just used for engineer debug before realy chip bring-up.
The dummy connector provides a display timing for drm driver. And it provides
a dummy encoder for crtc. This connector can be connected to either a realy
crtc(DPU) or a dummy crtc. It is useful for HAPS/ZEBU platform development.
Note that the dummy crtc should not be used for product.

Required properties:
  - compatible: value should be "sprd,dummy-connector";
  - display-timings: containing video timings [1];
  - port: a port node with endpoint definitions as defined in document [2].

[1]: Documentation/devicetree/bindings/display/panel/display-timing.txt.
[2]: Documentation/devicetree/bindings/media/video-interfaces.txt.


Example:

SoC specific DT entry:

	dummy-connector {
		compatible = "sprd,dummy-connector";

		display-timings {
			timing0 {
			clock-frequency = <58950000>;
				hactive = <720>;
				vactive = <1280>;
				hback-porch = <10>;
				hfront-porch = <10>;
				vback-porch = <10>;
				vfront-porch = <10>;
				hsync-len = <10>;
				vsync-len = <10>;
			};
		};

		port {
			dummy_connector_in: endpoint {
				remote-endpoint = <&dummy_crtc_out>;
			};
		};
	};


Board specific DT entry (if it has dsi & dphy node):

	&dsi {
		status = "disabled";
	};

	&dphy {
		status = "disabled";
	};
```

## Documentation/devicetree/bindings/display/sprd/dummy_crtc.txt
```
Dummy CRTC for Spreadtrum SoC
============================================================================

The dummy crtc is just used for engineer debug before realy chip bring-up.
There is a vsync timer in dummy crtc to send vblank event to userspace for
HW sync. This crtc can be connected to either a realy connector(DSI) or a
dummy connector. It is useful for HAPS/ZEBU platform development.
Note that the dummy crtc should not be used for product.

Required properties:
  - compatible: value should be "sprd,dummy-crtc";
  - port: a port node with endpoint definitions as defined in document [1].

[1]: Documentation/devicetree/bindings/media/video-interfaces.txt.


Example:

SoC specific DT entry:

	display-subsystem {
		compatible = "sprd,display-subsystem";
		ports = <&dummy_crtc_port>;
	};

	dummy-crtc {
		compatible = "sprd,dummy-crtc";

		dummy_crtc_port: port {
			dummy_crtc_out: endpoint {
				remote-endpoint = <&dummy_connector_in>;
			};
		};
	};


Board specific DT entry (if it has dpu & iommu node):

	&dpu {
		status = "disabled";
	};

	&iommu_dispc {
		status = "disabled";
	};
```

## Documentation/devicetree/bindings/display/sprd/panel.txt
```
Spreadtrum Generic MIPI Panel
================================================================

Required properties:
  - compatible: must be "sprd,generic-mipi-panel"
  - reg: panel ID
  - #address-cells, #size-cells: should be set respectively to <1> and <0>
  - port: video port for DPI input

Optional properties:
  - timing: containing video timings
            (Documentation/devicetree/bindings/display/panel/display-timing.txt)

Example
-------

Board specific DT entry:

	&dsi {
		status = "okay";
		#address-cells = <1>;
		#size-cells = <0>;

		panel {
			compatible = "sprd,generic-mipi-panel";
			#address-cells = <1>;
			#size-cells = <0>;
			reg = <0>;

			port {
				reg = <1>;
				panel_in: endpoint {
					remote-endpoint = <&dphy_out>;
				};
			};
		};
	};
```

## Documentation/devicetree/bindings/gpio/gpio-plus-sprd.txt
```
Spreadtrum GPIO PLUS controller bindings

Required properties:
- compatible: Should be "sprd,sharkl3-gpio-plus".
- reg: Define the base and range of the I/O address space containing
the GPIO controller registers.
- gpio-controller: Marks the device node as a GPIO controller.
- #gpio-cells: Should be <2>. The first cell is the gpio number and
the second cell is used to specify optional parameters.
- interrupt-controller: Marks the device node as an interrupt controller.
- #interrupt-cells: Should be <2>. Specifies the number of cells needed
to encode interrupt source.
- interrupts: Should be the port interrupt shared by all the gpios.

Example:
	ap_gpio: gpio@402c0000 {
		compatible = "sprd,sharkl3-gpio-plus";
		reg = <0 0x402c0000 0 0x1000>;
		gpio-controller;
		#gpio-cells = <2>;
		interrupt-controller;
		#interrupt-cells = <2>;
		interrupts = <GIC_SPI 130 IRQ_TYPE_LEVEL_HIGH>;
	};
```

## Documentation/devicetree/bindings/gpu/img,rogue.txt
```
IMG Rogue GPU
====================

Required properties:

- compatible :
  * Must contain one of the following:
    + "sprd,rogue"
  * which must be preceded by one of the following vendor specifics:
    + "sp9863a chip,rogue"

- reg : Physical base address of the device and length of the register area.

- interrupts : Contains the three IRQ lines required by IMG Rogue devices.

- interrupt-names : Contains the names of IRQ resources in the order they were
  provided in the interrupts property. Must contain: "job", "mmu", "gpu".


Optional properties:

- clocks : Phandle to clock for the Mali Midgard device.

- mali-supply : Phandle to regulator for the Mali device. Refer to
  Documentation/devicetree/bindings/regulator/regulator.txt for details.

- operating-points-v2 : Refer to Documentation/devicetree/bindings/power/opp.txt
  for details.


Example for a IMG Rogue:

gpu: gpu@60000000 {
	compatible = "sprd,rogue";
	reg = <0x60000000 0x100000>;
	syscons = <&pmu_regs REG_PMU_APB_PD_GPU_TOP_CFG
		MASK_PMU_APB_PD_GPU_TOP_FORCE_SHUTDOWN>,
		<&pmu_regs REG_PMU_APB_PD_GPU_CORE_CFG
			MASK_PMU_APB_PD_GPU_CORE_FORCE_SHUTDOWN>,
		<&pmu_regs REG_PMU_APB_PD_GPU_CORE_CFG
			MASK_PMU_APB_PD_GPU_CORE_AUTO_SHUTDOWN_EN>;
	syscon-names = "top_force_shutdown",
		"core_force_shutdown",
		"core_auto_shutdown";
	interrupts = <GIC_SPI 39 IRQ_TYPE_LEVEL_HIGH>;

	operating-points = <
		/* kHz    uV */
		256000    0
		384000    0
		550000    0
		>;

	sprd,dvfs-lists = <
		/* kHz  uV  idx div */
		256000  0    5   1
		384000  0    7   1
		550000  0    9   1
		>;
};
```

## Documentation/devicetree/bindings/i2c/i2c-sprd-hw.txt
```
I2C for Spreadtrum platforms

Required properties:
- compatible: should be one of following:
	  "sprd,sharkl5-hw-i2c",
	  "sprd,roc1-hw-i2c",
	  "sprd,sharkl3-hw-i2c",
	  "sprd,orca-hw-i2c",
	  "sprd,sharkl5pro-hw-i2c".
- reg: physical base address of the controller and length of memory mapped region.
- interrupts: Should contain I2C interrupt.
- clock-names: The i2C for spreadtrum clock-names should contain i2c source
	  clk node, source clk enable, i2c clock node, clock for hardware
	  i2c enable.
	  Clock-names is fixed in i2c drivers, and its purpose is to
	  constrain the order of clocks property.Consumers drivers
	  will use clock-names to match clock input names with clocks
	  specifiers.
- clocks: The freq of source clk connected to i2c.List of clock input name
	  strings sorted in the same order as the clocks property, the
	  source clk enable must config, and the i2c source clk node,
	  i2c clock node, clock for hardware i2c enable are options.
- clock-frequency: The property is communication frequency of i2c controller
- #address-cells: Should be <1> address cells for i2c device address
- #size-cells: Should be <0> as i2c addresses have no size component

Optional properties:
- Child nodes conforming to i2c bus binding

Examples:
i2c5: i2c@32060000 {
	compatible = "sprd,sharkl5-hw-i2c";
	reg = <0 0x32060000 0 0x1000>;
	interrupts = <GIC_SPI 68 IRQ_TYPE_LEVEL_HIGH>;
	clock-names = "source", "enable", "i2c",
		"clk_hw_i2c";
	clocks = <&ext_26m>,  <&aonapb_gate CLK_I2C_EB>,
		<&clk_hw_i2c>, <&clk_aon_top_gates 11>;
	clock-frequency = <400000>;
	#address-cells = <1>;
	#size-cells = <0>;
};
```

## Documentation/devicetree/bindings/iio/sprd_hub/sprd-sensorhub.txt
```
Unisoc sensor hub bindings

Unisoc's some SoCs integrates sensor hub. This sensor hub driver collect and
analyze data uploaded from sensors.

Required Properties:
- compatible: should be the following.
  - "sprd,sharkl3-sensorhub": for Sharkl3-compatible sensor hub,
  - "sprd,sharkl5-sensorhub": for Sharkl5-compatible sensor hub,
  - "sprd,sharkl5Pro-sensorhub": for Sharkl5pro-compatible sensor hub,
  - "sprd,roc1-sensorhub": for Roc1-compatible sensor hub


Example:
	sprd-sensorhub {
		compatible = "sprd,sharkl5-sensorhub";
	};
```

## Documentation/devicetree/bindings/input/sprd-keypad.txt
```
*Spreadtrum SoCs keypad controller device tree bindings
=============================================================

Keypad controller is used to interface a SoC with a matrix-keypad device.
The keypad controller supports multiple row and column lines.
A key can be placed at each intersection of a unique row and a unique column.
The keypad controller can sense a key-press and key-release and report the
event using a interrupt to the cpu.

Required SoC Specific Properties:
- compatible: Should be "sprd,s9820e-keypad".
- reg: Physical base address of the controller and length of memory mapped
  region.
- interrupts: The interrupt number to the cpu.
- debounce-interval: Debouncing interval time in milliseconds.
  If not specified defaults to 5.

Required Properties:
- linux,keymap: An array of packed 1-cell entries containing the equivalent
  of row, column and linux key-code. The 32-bit big endian cell is packed
  as:
	row << 24 | column << 16 | key-code
- keypad,num-rows: Number of row lines connected to the keypad controller.
- keypad,num-columns: Number of column lines connected to the keypad
  controller.

Optional Properties specific to linux:
- wakeup-source: Use any event on keypad as wakeup event.
- linux,repeat: Enable autorepeat feature.

Example:
	keypad@40250000 {
		compatible = "sprd,s9820e-keypad";
		reg = 	<0x40250000 0x1000>;
		interrupts = <GIC_SPI 36 IRQ_TYPE_NONE>;
		clocks = <&aonapb_gate CLK_KPD_EB>,
			<&aonapb_gate CLK_KPD_RTC_EB>;
		clock-names = "enable", "rtc";
		keypad,num-rows= <3>;
		keypad,num-columns = <3>;
		debounce-inteval = <5>;
		linux,keymap = < 0x00000001
				 0x01000002
				 0x00020003>;
		status = "okay";
	};
```

## Documentation/devicetree/bindings/input/touchscreen/adaptive-touchscreen.txt
```
Device-Tree bindings for adaptive touchscreen framework

Required properties:
 - compatible: must be "adaptive-touchscreen"
 - gpios: the reset and interrupt GPIO number

Optional properties:
 - reg                   : I2C address of some designated touchscreen
                           controller, this value will be a reference for
                           adaptive touchscreen driver.
 - virtualkeys           : virtual key settings in u32 array form, a valid
                           virtual key setting must have keycode, x, y, width,
                           height in order.
 - touchscreen-size-x    : the reporting area width
 - touchscreen-size-y    : the reporting area height
 - surface-width         : width of displayed surface
                           If not set, we don't resize virtual key hit box.
 - surface-height        : height of displayed surface
                           If not set, we don't resize virtual key hit box.
 - virtualkey-report-abs : indicated whether we should report virtual key as
                           ABS or KEY event.
 - firmware-auto-upgrade : indicated whether we do firmware upgrading in
                           booting.
 - controller            : the designated controller name.
                           If not specified, driver will select property
                           controller automatically.
 - avdd-supply           : the name of regulator supply.
                           If set, driver will do power control in suspend
                           and resume time.

Example nodes:
&i2c0 {
	/* ... */
	touchscreen {
		compatible = "adaptive-touchscreen";
		reg = <0x26>;
		gpios = <&ap_gpio 145 0
			&ap_gpio 144 0>;
		controller = "mstar,MSG21XXA";
		firmware-auto-upgrade;
		virtualkeys = <580 120 1350 60 45
			172 360 1350 60 45
			158 600 1350 60 45>;
	};
	/* ... */
};
```

## Documentation/devicetree/bindings/input/touchscreen/chipone-tddi.txt
```
* Chipone tddi touchscreen interface

Required properties:
- compatible		: "chipone-tddi"
- reg			: I2C slave address
- chipone,rst-gpio	: touch controller reset gpio
- chipone,irq-gpio	: touch controller interrupt gpio
- chipone,x-res		: horizontal resolution of tp
- chipone,y-res		: vertical resolution of tp

Example:

	chipone_tddi@48 {
		compatible = "chipone-tddi";
		reg = <0x48>;
		chipone,rst-gpio = <&ap_gpio 145 0x00>;
		chipone,irq-gpio = <&ap_gpio 144 0x00>;
		chipone,x-res = <720>;
		chipone,y-res = <1520>;
	};
```

## Documentation/devicetree/bindings/input/touchscreen/focaltech-spi-ts.txt
```
Focaltech touch controller with SPI interface

Required properties:
 - compatible:	"focaltech,fts"
 - gpios: 	the reset and interrupt GPIO number
 - reg: 	SPI chipselect
 - interrupts:	An interrupt node describing the IRQ line the chip's

Example nodes:

&spi2 {
	/* ... */
	focaltech@0 {
		compatible = "focaltech,fts";
		reg = <0x0>;
		spi-max-frequency = <6000000>;
		interrupt-parent = <&ap_gpio>;
		interrupts = <144 0x2000>;
		focaltech,reset-gpio = <&ap_gpio 145 GPIO_ACTIVE_HIGH>;
		focaltech,irq-gpio = <&ap_gpio 144 GPIO_ACTIVE_HIGH>;
		focaltech,max-touch-number = <5>;
		focaltech,display-coords =  <0 0 720 1600>;
	};
	/* ... */
};
```

## Documentation/devicetree/bindings/input/touchscreen/synaptics-td4310.txt
```
Synaptics TD4310 I2C touchscreen controller

Required properties:
 - compatible: "synaptics,dsx"
 - gpios: 	the reset and interrupt GPIO number
 - reg: 	I2C slave address of the chip

Example nodes:

&i2c3 {
	/* ... */
	synaptics-touch@20 {
		compatible = "synaptics,dsx";
		reg = <0x20>;
		gpios = <&ap_gpio 145 GPIO_ACTIVE_HIGH
			&ap_gpio 144 GPIO_ACTIVE_HIGH>;
	};
	/* ... */
};
```

## Documentation/devicetree/bindings/interrupt-controller/sprd,ipa-intc.txt
```
Spreadtrum ipa level2 interrupt controller

This interrupt controller is only used on roc1 chip. It has the
following properties:

- outputs a single interrupt signal to its interrupts controller parent(GIC).

Required properties:

- compatible: should be "sprd,ud710-ipa-intc"
- reg: specifies the register base physical address and length
- interrupt-controller: identifies the node as an interrupt controller
- #interrupt-cells: specifies the number of cells needed to encode an interrupt
		    source, should be 1.
		    It specifies the interrupt number in this controller.
- interrupts: specifies the interrupt line in the interrupt-parent controller
	      (GIC) node
- syscons: The global registers of ipa interrupt controller.
	   Each group syscon has 3 cells.
- syscon-name: each mask of global register needs a corresponding name.

Example:

ipa_intc: ipa@20e03000 {
	compatible = "sprd,ud710-ipa-intc";
	reg = <0 0x20e03000 0 0x1000>;
	interrupt-controller;
	interrupts = <GIC_SPI 146 IRQ_TYPE_LEVEL_HIGH>;
	#interrupt-cells = <1>;
	syscon-names =  "ipa_intc_eb";
	syscons = <&ipa_ahb_regs REG_IPA_AHB_IPA_EB MASK_IPA_AHB_INTC_EB>;
};
```
