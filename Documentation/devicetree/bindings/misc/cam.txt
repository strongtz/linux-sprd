## Documentation/devicetree/bindings/misc/cam.txt
```
Spreadtrum Camera devices

This node provides properties for controlling the Spreadtrum Camera device.

Required properties:

 - compatible should be one of following:
	"sprd,sharkl3-cam"
	"sprd,sharkl5pro-cam"

Example:
dcam: dcam@60a00000 {
	compatible = "sprd,sharkl3-cam";
}
```

## Documentation/devicetree/bindings/misc/sprd_apdu.txt
```
Spreadtrum APDU driver
================================================================

Required properties:
 - compatible: should be one of the following:
   "sprd,roc1-apdu"
 - reg: physical base address of the musb and length of memory mapped region
 - interrupts: interrupt number for the musb controller

Example:
-------

Board specific DT entry:

	apdu_if: apdu@32380000 {
		compatible = "sprd,roc1-apdu";
		reg = <0 0x32380000 0 0x10000>;
		interrupts = <GIC_SPI 187 IRQ_TYPE_LEVEL_HIGH>;
	};
```

## Documentation/devicetree/bindings/misc/sprd_camera/sprd,camera_flash.txt
```
Spreadtrum Camera Flash devices

This node provides properties for controlling the Spreadtrum Camera Flash device.

Required properties:

 - compatible should be one of followings:
	"sprd,flash-sc2731"
	"sprd,sc2721-flash"
	"sprd,sc2720-flash"
	"sprd,flash-sgm37891"
	"sprd,sc2703-flash"
	"sprd,lcd-flash"
	"sprd,flash-wd3124da"

Example:

flash-sc2731 {
	compatible = "sprd,flash-sc2731";
	sprd,pmic-flash = <&pmic_flash>;
	flash0-gpios = <&ap_gpio 167 0>;
	flash1-gpios = <&ap_gpio 168 0>;
};

pmic_flash: flash@2a8 {
	compatible = "sprd,sc2721-flash";
	reg = <0x2a8>;
};

pmic_flash: flash@1f4 {
	compatible = "sprd,sc2720-flash";
	reg = <0x1f4>;
};

flash-gpios {
	compatible = "sprd,flash-sgm37891";
	flash-ic = <37891>;
	flash-1w-gpios = <&ap_gpio 30 0>;
	flash-torch-en-gpios = <&ap_gpio 87 0>;
	flash-en-gpios = <&ap_gpio 89 0>;
};

flash: sc2703-flash@4a {
	compatible = "sprd,sc2703-flash";
	reg = <0x4a>;
	flash-chip-en-gpios = <&ap_gpio 137 0>;
};

flash_lcd: flash-lcd {
	compatible = "sprd,lcd-flash";
	sprd,dpu = <&dpu>;
	sprd,backlight = <&pwm_backlight>;
	status = "okay";
};
```

## Documentation/devicetree/bindings/misc/sprd_mmsys_pw_domain.txt
```
syscon-names: global register bits name, order and name should the same as code,
             code file drivers/soc/sprd/domain/mmsys_pw_domain_r6p0.c
syscons: global register bits, <regmap,register address, mask>

clock-names: clock name for mmsys ahb enable.
clocks: clock for mmsys ahb enable.

example(Maybe some change later):
mm_domain: mm_domain {
	compatible = "sprd,mm-domain";
	syscon-names = "chip_id0",
		"chip_id1",
		"force_shutdown",
		"shutdown_en",
		"power_state",
		"mm_qos_ar",
		"mm_qos_aw";
	syscons = <&aon_apb_regs REG_AON_APB_AON_CHIP_ID0 MASK_AON_APB_AON_CHIP_ID0>,
		<&aon_apb_regs REG_AON_APB_AON_CHIP_ID1 MASK_AON_APB_AON_CHIP_ID1>,
		<&pmu_apb_regs REG_PMU_APB_PD_MM_TOP_CFG MASK_PMU_APB_PD_MM_TOP_FORCE_SHUTDOWN>,
		<&pmu_apb_regs REG_PMU_APB_PD_MM_TOP_CFG MASK_PMU_APB_PD_MM_TOP_AUTO_SHUTDOWN_EN>,
		<&pmu_apb_regs REG_PMU_APB_PWR_STATUS3_DBG MASK_PMU_APB_PD_MM_TOP_STATE>,
		<&mm_ahb_regs REG_MM_AHB_MM_QOS MASK_MM_AHB_AR_QOS_THRESHOLD_MM>,
		<&mm_ahb_regs REG_MM_AHB_MM_QOS MASK_MM_AHB_AW_QOS_THRESHOLD_MM>;

	clock-names = "mm_eb",
		"mm_ahb_eb",
		"clk_mm_ahb"
		"clk_mm_ahb_parent",
		"mm_mtx_eb",
		"clk_mm_mtx"
		"clk_mm_mtx_parent";
	clocks = <&aonapb_gate CLK_MM_EB>,
		<&mm_gate CLK_MM_CKG_EB>,
		<&mm_clk CLK_MM_AHB>,
		<&mm_clk CLK_TWPLL_153M6>
		<&mm_gate CLK_ISP_AHB_EB>, /* TBC */
		<&mm_clk CLK_MM_MTX>,
		<&mm_clk CLK_ISPPLL_468M>;
	mm_qos = <0x0D 0x0D>; /* AR, AW */
};
```

## Documentation/devicetree/bindings/misc/sprdwcn/sprd,marlin2_integrate.txt
```
Spreadtrum SC23XX platform devices.
Spreadtrum SC2342_INTEG platform devices.

This node provides properties for controlling the SPREADTRUM wireless device.

Required properties:

- compatible : used to match devices.
- sprd,name : defined as being similar to the node name.
- sprd,syscon-ap-apb: controller of wcn's apb bus.
- sprd,ctrl-probe-num: support btwf and gnss.
- sprd,ctrl-reg: offset of some regisers for power on.
- sprd,ctrl-rw-offset: support some RW types of registers.
- sprd,ctrl-type: types of registers.
- sprd,ctrl-shutdown-reg: offset of some regisers for shutdown.
- reg: mapping of the size of the address space.
- memory_region: wcn reserved.
- vddwcn-supply: power supply.

Example:

	wcn_btwf: cpwcn_btwf {
		compatible = "sprd,integrate_marlin";
		sprd,name = "wcn_btwf";
		sprd,syscon-ap-apb = <&aon_apb_controller>;
		sprd,ctrl-probe-num = <2>;
		sprd,ctrl-reg = <0x1578 0x30a0 0x2100 0x20cc 0x20b0 0x157c>;
		sprd,ctrl-rw-offset = <0x1000 0x0 0x2000 0x2000 0x2000 0x1000>;
		sprd,ctrl-type = <0x0 0x2 0x1 0x1 0x1 0x0>;
		sprd,ctrl-shutdown-reg = <0x257c 0x10b0>;
		reg = <0x0 0x88000000 0x0 0x180000>;
		memory_region = < &wcn_reserved >;
		vddwcn-supply = <&vddcon>;
	};

	wcn_gnss: cpwcn_gnss {
		compatible = "sprd,integrate_gnss";
		sprd,name = "wcn_gnss";
	};

	wcn_spipe {
		compatible = "sprd,spipe";

		spipe_cpwcn {
			sprd,name = "spipe_wcn";
		};

		 spipe_gnss {
			 sprd,name = "sttygnss0";
		 };
	};

	wcn_btwf: cpwcn_btwf {
		compatible = "sprd,integrate_marlin";
		sprd,name = "wcn_btwf";
	};

	 wcn_gnss: cpwcn_gnss {
		compatible = "sprd,integrate_gnss";
		sprd,name = "wcn_gnss";
	};

	wcn_wifi_cmd {
		compatible = "sprd,swcnblk";
		sprd,name = "wcn_wifi_cmd";
	};

	wcn_wifi_data0 {
		compatible = "sprd,swcnblk";
		sprd,name = "wcn_wifi_data0";
	};

	wcn_wifi_data1 {
		compatible = "sprd,swcnblk";
		sprd,name = "wcn_wifi_data1";
	};

	wcn_bt {
		compatible = "sprd,wcn_internal_chip";
		sprd,name = "ttyBT";
	};

	wcn_fm {
		compatible = "sprd,wcn_internal_chip";
		sprd,name = "fm";
	};

	gnss_common_ctl {
		compatible = "sprd,gnss_common_ctl";
		sprd,name = "gnss_common_ctl";
	};
```

## Documentation/devicetree/bindings/misc/sprdwcn/sprd,marlin3.txt
```
Spreadtrum SC2355 platform devices.
Spreadtrum UMW2652 platform devices.
UMW2652 is the little of SC2355.

This node provides properties for controlling the SPREADTRUM wireless device.

Required properties:

- compatible : Should be "sprd,marlin3".
- m2-to-ap-coexist-gpios : sc2355 GPIO0, used for debug.
- m2-wakeup-ap-gpios : sc2355 GPIO1, CP2 wake up AP for SDIO.
- permit-ap-send-gpios : SC2355 GPIO2. permit ap send data to wcn chip.
- wait-ge2 : used for GNSS download through SDIO, not use UART.
- common-chip : BTWF and GNSS share the same chip_eb pin.
- keep-power-on : keep wcn power on.
- adma-tx : supprt SDIO ADMA function in tx side.
- adma-rx : supprt SDIO ADMA function in rx side.
- pwrseq : SDIO's power sequencing.
- post-power-on-delay-ms : delay value when power on/off.
- bound-avdd12 : avdd12 not enable,just config the valtage.
- vddgen1-enable : for sharkl5, vddwcn always on need config vddgen1.
- vddgen1-bound-chip :  the four member:<addr mask unboundval boundval>.

Optional properties:
- vddio-supply = <&vddgen>: this supply is alway on.
- power-off :SC2355 chip not power down.

Example:

	sprd_marlin3: sprd-marlin3 {
		compatible = "sprd,marlin3";
		m2-to-ap-coexist-gpios = <&ap_gpio 119 GPIO_ACTIVE_LOW>;
		m2-wakeup-ap-gpios = <&ap_gpio 77 GPIO_ACTIVE_LOW>;
		permit-ap-send-gpios = <&ap_gpio 69 GPIO_ACTIVE_LOW>;
		reset-gpios = <&ap_gpio 95 GPIO_ACTIVE_LOW>;
		enable-gpios = <&ap_gpio 94 GPIO_ACTIVE_LOW>;
		dvdd12-supply = <&vddcon>;
		avdd12-supply = <&vddcon>;
		avdd33-supply = <&vddwifipa>;
		clock-names = "clk_32k","source","enable";
		clocks = <&aon_clk CLK_AUX0>,
		         <&ext_32k>,
			 <&aonapb_gate CLK_AUX0_EB>;
		sdhci-name = <&sdio1>;
		common-chip;
		keep-power-on;
		wait-ge2;
		adma-tx;
		adma-rx;
		vddgen1-enable;
		vddgen1-bound-chip = <0x1a4c 0x1 0x0 0x1>;
		pwrseq;
		post-power-on-delay-ms = <20>;
	};

	gnss-common-ctl {
		compatible = "sprd,gnss-common-ctl";
	};
```

## Documentation/devicetree/bindings/mmc/sprd-mmc.txt
```
* Spreadtrum MMC Host Controller

The Spreadtrum MMC Host Controller provides an interface for MMC, SD, and SDIO
types of memory cards. This file documents differences between the core
properties described by mmc.txt and the properties used by the Spreadtrum MMC
driver.

Required properties:
- compatible:
 should be "sprd,sdhc-r11p1",
 in order to compatible with MMC controller version
- reg: Registers location and length
- interrupts: exactly one interrupt specifier
- clock-names: The clock-names must have "sdio_clk", "sdio_clk_source" and
	       "sdio_ahb_enable".
	       The sdio for spreadtrum clock-names should contain sdio
	       clock node, source clk node ,sdio module enable clock node.
	       Clock-names is fixed in sdio drivers, and its purpose is to
	       constrain the order of clocks property.Consumers drivers
	       will use clock-names to match clock input names with clocks
	       specifiers.
- clocks: The freq of source clk connected to sdio.List of clock input name
	  strings sorted in the same order as the clocks property.

Optional properties:
- cd-gpios: specify GPIOs for card detection, see gpio binding.and that will
  delete "non-removable" in sprd driver code.
- vmmc-supply: phandle to input sdio core voltage
- vqmmc-supply: phandle to input sdio signal voltage
- voltage-ranges: VDD voltage ranges
- cap-mmc-hw-reset: eMMC hardware reset is supported
- sprd,dly-invert : clock data write line invert

*NOTE*
- The following properties are defined by spreadtrum. They are not standard
 properties of SDIO
- sprd,name: The name of the MMC device. For Example, "emmc", "wifi" and "sd".
  The capabilities of different MMC device can be set by this property in
  spreadtrum MMC host driver
- sprd,delay: This property value that obtained by hardware testing are fixed.
 prop-encoded-array <wr-dl rd-pos-dl rd-neg-dl> where:
    * wr-dl is the delay value between sdio clock signal and data write in
        milliseconds
    * rd-pos-dl is the delay value between sdio clock signal and posedge data
        read in milliseconds
    * rd-neg-dl is the delay value between sdio clock signal and negedge data
        read in milliseconds

Example:

sdio0: sdio@1100000 {
	compatible  = "sprd,sdhc-r11p1";
	reg = <0x1100000 0x1000>;
	interrupts = <GIC_SPI 19 IRQ_TYPE_LEVEL_HIGH>;
	clock-names = "sdio_clk", "sdio_clk_source","sdio_apb_enable";
	clocks = <&clk_sdio0>, <&clk_twpll_384m>, <&clk_ap_apb_gates 22>;
	status = "disabled";
};
```

## Documentation/devicetree/bindings/mtd/sprd-nand.txt
```
* Spreadtrum Nand Host Controller

The Spreadtrum Nand Host Controller provides an interface for Nand.
This file documents differences between the coreproperties described by Nand.txt
and the properties used by the Spreadtrum Nand driver.

Required properties:
- compatible:
 should be "sprd,orca-nandc"
 in order to compatible with Nand controller version
- reg: Registers location and length
- interrupts: exactly one interrupt specifier
- sprd,random-mode: if set, nandc will enable randomizer on IO data trans;
- clocks: Freq of source clk of nand controller ECC and ahb enable or disable
Example:

nandc: nand-controller@21300000 {
	compatible = "sprd,orca-nandc";
	reg = reg = <0 0x21300000 0 0x1000>;
	interrupts = <GIC_SPI 59 IRQ_TYPE_LEVEL_HIGH>;
	sprd,random-mode;
	clock-names = "nandc_clk","nandc_ecc_clk","nandc_parent_sdr",
		"nandc_parent_ddr","nandc_ahb_enable","nandc_ecc_enable",
		"nandc_26m_enable","nandc_1x_enable","nandc_2x_enable";
	clocks = <&aon_clk CLK_NANDC_2X>,
		 <&ap_clk CLK_NANDC_ECC>,
		 <&g3_pll CLK_TWPLL_219M4>,
		 <&g3_pll CLK_TWPLL_307M2>,
		 <&apahb_gate CLK_NANDC_EB>,
		 <&apahb_gate CLK_NANDC_ECC_EB>,
		 <&apahb_gate CLK_NANDC_26M_EB>,
		 <&aonapb_gate CLK_NANDC_1X_EN>,
		 <&aonapb_gate CLK_NANDC_2X_EN>;
	status = "disabled";
};
```

## Documentation/devicetree/bindings/nvmem/sprd-cache-efuse.txt
```
= Spreadtrum normal eFuse device tree bindings =

Required properties:
- compatible: Should be one of the following.
	"sprd,sharkl5-cache-efuse"
- reg: Base address of efuse storage in efuse cache scheme

= Data cells =
Are child nodes of eFuse, bindings of which as described in
bindings/nvmem/nvmem.txt

Example:

	cache_efuse: efuse@15c00 {
		compatible = "sprd,sharkl5-cache-efuse";
		reg = <0 0x15c00 0 0x3ff>;

		/* Data cells */
		thermal_calib: calib@10 {
			reg = <0x10 0x2>;
		};
	};

= Data consumers =
Are device nodes which consume nvmem data cells.

Example:

	thermal {
		...
		nvmem-cells = <&thermal_calib>;
		nvmem-cell-names = "calibration";
	};
```

## Documentation/devicetree/bindings/nvmem/sprd-efuse.txt
```
= Spreadtrum normal eFuse device tree bindings =

Required properties:
- compatible: Should be one of the following.
	"sprd,sharkl5-efuse"
- reg: Specify the address offset of efuse controller.
- clocks: Reference to a phandle of a clock provider node.
- hwlocks: Reference to a phandle of a hwlock provider node.

= Data cells =
Are child nodes of eFuse, bindings of which as described in
bindings/nvmem/nvmem.txt

Example:

	nefuse: efuse@40240000 {
		compatible = "sprd,sharkl5_efuse";
		reg = <0 0x40240000 0 0x10000>;
		clock-names = "enable";
		clocks = <&clk_aon_apb_gates0 13>;
		hwlocks = <&hwslock1 8>;

		/* Data cells */
		thermal_calib: calib@10 {
			reg = <0x10 0x2>;
		};
	};

= Data consumers =
Are device nodes which consume nvmem data cells.

Example:

	thermal {
		...
		nvmem-cells = <&thermal_calib>;
		nvmem-cell-names = "calibration";
	};
```

## Documentation/devicetree/bindings/pam_ipa/pam_ipa.txt
```
PAM IPA for Spreadtrum platforms

Required properties:
- compatible: Should be "sprd,pam-ipa".
- reg: Specify the physical base address of the controller and length
  of memory mapped region.
- power-domains: Should be <&pd_ipa_sys>.
- vpower-supply: regulator for ipa_sys power
- syscons: Should contain the base address, offset and bit for each entry in "syscon-names".
- syscon-names: global register bits name, order and name should the same as code.
- sprd,cp-ul-intr-to-ap: cp ul common fifo interrupt to AP. 0: no, 1: yes
- sprd,cp-ul-threshold: cp ul common fifo threshold interrupt
- sprd,cp-ul-timeout: cp ul common fifo timeout interrupt
- sprd,cp-ul-flowctrl-mode: flow ctrl mode.
				0: rx fifo empty
				1: tx fifo full
				2: rx fifo empty & tx fifp full
- sprd,cp-ul-enter-flowctrl-watermark: enter flow ctrl watermark.
- sprd,cp-ul-exit-flowctrl-watermark: exit flow ctrl watermark.
- sprd,cp-dl-intr-to-ap: cp dl common fifo interrupt to AP. 0: no, 1: yes
- sprd,cp-dl-threshold: cp dl common fifo threshold interrupt
- sprd,cp-dl-timeout: cp dl common fifo timeout interrupt
- sprd,cp-dl-flowctrl-mode: flow ctrl mode.
				0: rx fifo empty
				1: tx fifo full
				2: rx fifo empty & tx fifp full
- sprd,cp-dl-enter-flowctrl-watermark: enter flow ctrl watermark.
- sprd,cp-dl-exit-flowctrl-watermark: exit flow ctrl watermark.

Examples:
	pam_ipa: pam-ipa@21140000 {
		compatible = "sprd,pam-ipa";
		reg = <0 0x21140000 0 0x100>;
		reg-names = "pam-ipa-base";
		power-domains = <&pd_ipa_sys>;
		vpower-supply = <&vddipa>;
		syscons = <&ipa_ahb_regs
			  REG_IPA_AHB_IPA_EB
			  MASK_IPA_AHB_PAM_IPA_EB>;
		syscon-names = "enable";

		sprd,cp-ul-intr-to-ap = <0>;
		sprd,cp-ul-threshold = <1>;
		sprd,cp-ul-timeout = <5>;
		sprd,cp-ul-flowctrl-mode = <1>;
		sprd,cp-ul-enter-flowctrl-watermark = <0x10>;
		sprd,cp-ul-exit-flowctrl-watermark = <0x04>;
		sprd,cp-dl-intr-to-ap = <0>;
		sprd,cp-dl-threshold = <0x10>;
		sprd,cp-dl-timeout = <0>;
		sprd,cp-dl-flowctrl-mode = <0>;
		sprd,cp-dl-enter-flowctrl-watermark = <0x24>;
		sprd,cp-dl-exit-flowctrl-watermark = <0x04>;
		sprd,pam-ipa-hw-ver = <1>;
		sprd,pam-ipa-hw-mode = <0>;
	};
```
