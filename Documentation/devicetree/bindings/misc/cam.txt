## Documentation/devicetree/bindings/pci/sprd-pcie.txt
```
Spreadtrum PCIe controller DT description

Spreadtrum PCIe host controller is based on Designware PCI core.
It shares common functions with PCIe Designware core driver and inherits
common properties defined in
Documentation/devicetree/bindings/pci/designware-pci.txt.

Additional properties are described here:

Required properties:
 - compatible: Should be "sprd,pcie" for RC
	       Should be "sprd,pcie-ep" for EP
 - num-lanes as specified in ../designware-pcie.txt

HOST MODE
=========
 - reg: Should contain dbi, config registers location and length.
 - reg-names: Must include the following entries:
	      "dbi": controller configuration registers;
	      "config": PCIe configuration space registers.
 - #address-cells,
   #size-cells,
   #interrupt-cells,
   device_type,
   ranges,
   interrupt-map-mask,
   interrupt-map: as specified in ../designware-pcie.txt

 - sprd,pcie-startup-syscons:
	The global registers of pcie are used when pcie startup.
	Each group syscon has 6 cells as follows:
	- phandle of pcie syscon for used for pcie host controller
	- the type of syscon:
          0： set/clear, use regmap_update_bits() to operate these registers
          1: not set/clear, use regmap_read() and regmap_write() to operate
             these registers
	- the delay value: the delay time (unit: ms) after the syscon is set
	- register: the register to be operated by the syscon
	- mask: the mask of the syscon register
	- value: the value to be set to the syscon register mask

 - sprd,pcie-shutdown-syscons:
	The global registers of pcie are used when pcie shutdown.
	This property is the same as sprd,pcie-startup-syscons.
 - sprd,pcie-resume-syscons:
	The global registers of pcie are used when pcie resume.
	This property is the same as sprd,pcie-startup-syscons.

 - sprd,pcie-suspend-syscons:
	The global registers of pcie are used when pcie suspend.
	This property is the same as sprd,pcie-startup-syscons.

 - sprd,pcie-aspml1p2-syscons:
	The global registers of pcie are used when pcie enter ASPM L1.2.
	This property is the same as sprd,pcie-startup-syscons.

 - dummy@0 and dummy@1: dummy nodes.
	   some pcie controllers have two or more interrupt lines. one connect
	   to ipa level2 interrupt controller (e.g. pcie legacy irq), which
	   may belong to dummy@0. and the others connect to GIC(e.g. MSI
	   controller), which may belong to dummy@1

 - no-pcie: no pcie device.
 - label: describe the interrupt connect to which interrupt controller
 - interrupt-parent: specifies the phandle to the parent interrupt controller
		     this one is cascaded from.
 - #interrupt-cells: specifies the number of cells needed to encode an interrupt
		     source. it may be 3 or 1.
	-1. if the vlue of this property is 3:
		a) the 1st cell is the interrupt type: SPI interrupt
		b) the 2nd cell is the interrupt number for the interrupt type
		c) the 3rd cell is the flags, it must be active high
		   level-sensitive
	-2 if the value of this property is 1:
		The only value is the interrupt number
- interrupts: as specified about #interrupt-cells

DEVICE MODE
===========
 - reg : Three register ranges as listed in the reg-names property
 - reg-names: "dbi" for the standard configuration registers as
		they are locally accessed within the DIF CS space
	       "dbi2" for the standard configuration registers as
		they are locally accessed within the DIF CS2 space
	       "addr_space" used to map remote RC address space
 - num-ib-windows: number of inbound address translation windows
 - num-ob-windows: number of outbound address translation windows

Example:
	pcie0@2b100000 {
		compatible = "sprd,pcie", "snps,dw-pcie";
		reg = <0x0 0x2b100000 0x0 0x2000>,
		      <0x2 0x00000000 0x0 0x2000>;
		reg-names = "dbi", "config";
		#address-cells = <3>;
		#size-cells = <2>;
		device_type = "pci";
		ranges = <0x01000000 0x0 0x00000000 0x2 0x00002000 0x0 0x00010000
			  0x03000000 0x0 0x10000000 0x2 0x10000000 0x1 0xefffffff>;
		bus-range = <0  15>;
		num-lanes = <1>;
		num-vectors = <256>;
		num-viewport = <8>;
		sprd,pcie-startup-syscons =
			<&ipa_ahb_regs 0 0
				REG_IPA_AHB_IPA_EB
				MASK_IPA_AHB_PCIE2_EB
				(0x1 << 8)>,
			<&pmu_apb_regs 0 20
				REG_PMU_APB_PCIE_PERST_CTRL_CFG
				MASK_PMU_APB_REG_PCIE2_PERST_N_ASSERT
				0>,
			<&pmu_apb_regs 0 0
				REG_PMU_APB_PCIE_PERST_CTRL_CFG
				MASK_PMU_APB_PCIE2_PERST_N_AUTO_CTRL_EN
				0x1>;
		sprd,pcie-resume-syscons =
			<&pmu_apb_regs 0 0
				REG_PMU_APB_XTLBUF_PCIEH_REL_CFG
				MASK_PMU_APB_XTLBUF_PCIEH_FRC_ON
				(0x1 << 7)>,
			<&pmu_apb_regs 0 0
				REG_PMU_APB_XTLBUF_PCIEV_REL_CFG
				MASK_PMU_APB_XTLBUF_PCIEV_FRC_ON
				(0x1 << 7)>;
		sprd,pcie-suspend-syscons =
			<&pmu_apb_regs 0 0
				REG_PMU_APB_PCIE_PERST_CTRL_CFG
				MASK_PMU_APB_PCIE2_PERST_N_AUTO_CTRL_EN
				0>,
			<&pmu_apb_regs 0 20
				REG_PMU_APB_PCIE_PERST_CTRL_CFG
				MASK_PMU_APB_REG_PCIE2_PERST_N_ASSERT
				(0x1 << 1)>,
			<&ipa_ahb_regs 0 0
				REG_IPA_AHB_IPA_EB
				MASK_IPA_AHB_PCIE2_EB
				0>;
		sprd,pcie-aspml1p2-syscons =
			<&anlg_pcie20_phy_regs 1 0
				REG_ANALOG_USB30_CFGA_ANA_CFG13
				MASK_PIPE_CFGA_ANA_CFG13_CFG_FORCE_REFCLK_EN
				(0x1 << 23)>;
		dummy@0 {
			label = "parent_gic_intc";
			interrupt-parent = <&gic>;
			#interrupt-cells = <3>;
			interrupts = <GIC_SPI 153 IRQ_TYPE_LEVEL_HIGH>;
		};
		dummy@1 {
			label = "parent_ipa_intc";
			interrupt-parent = <&ipa_intc>;
			#interrupt-cells = <1>;
			interrupts = <20>;
		};
		no-pcie;
	};

	pcie1@2b100000 {
		compatible = "sprd,pcie-ep", "snps,dw-pcie";
		reg = <0x0 0x2b100000 0x0 0x2000>,
		      <0x0 0x2b108000 0x0 0x2000>,
		      <0x2 0x00000000 0x2 0x00000000>;
		reg-names = "dbi", "dbi2","addr_space";
		interrupts = <GIC_SPI 55 IRQ_TYPE_LEVEL_HIGH>;
		num-lanes = <1>;
		num-ib-windows = <6>;
		num-ob-windows = <8>;
	};
```

## Documentation/devicetree/bindings/power/reset/sc27xx-poweroff.txt
```
UNISOC Poweroff Driver

This IP block in ths unisoc SoC that only deals with different ways to power the system down.

Required properties:
- compatible:
  -"sprd,sc2721-poweroff" for SC2721 poweroff
  -"sprd,sc2730-poweroff" for SC2730 poweroff
  -"sprd,sc2731-poweroff" for SC2731 poweroff
- reg: Specifies the physical address of the poweroff register.

Example:
poweroff@1820 {
	compatible = "sprd,sc27xx-poweroff", "sprd,sc2730-poweroff";
	reg = <0x1820>;
};
```

## Documentation/devicetree/bindings/power/supply/bq2560x_charger.txt
```
TI BQ2560X PMIC battery charger binding

Required properties:
 - compatible: Should be "ti,bq2560x_chg".
 - reg: Address offset of charger register.
 - phys: Contains a phandle to the USB phy.

Optional Properties:
- monitored-battery: phandle of battery characteristics devicetree node.
  The charger uses the following battery properties:
- charge-term-current-microamp: current for charge termination phase.
- constant-charge-voltage-max-microvolt: maximum constant input voltage.
  See Documentation/devicetree/bindings/power/supply/battery.txt
- extcon: used to detect if vbus is high level.
Example:

	bat: battery {
		compatible = "simple-battery";
		charge-term-current-microamp = <120000>;
		constant-charge-voltage-max-microvolt = <4350000>;
		......
	};

	&i2c4 {
		status = "okay";
		clock-frequency = <400000>;

		bq2560x_chg: charger@6a {
			compatible = "ti,bq2560x_chg";
			reg = <0x6a>;
			phys = <&hsphy>;
			monitored-battery = <&bat>;
			extcon = <&extcon_gpio>;
		};
	};
```

## Documentation/devicetree/bindings/power/supply/charger-manager.txt
```
charger-manager bindings
~~~~~~~~~~~~~~~~~~~~~~~~

Required properties :
 - compatible : "charger-manager"
 - <>-supply : for regulator consumer
 - cm-num-chargers : number of chargers
 - cm-chargers : name of chargers
 - cm-fuel-gauge : name of battery fuel gauge
 - subnode <regulator> :
	- cm-regulator-name : name of charger regulator
	- subnode <cable> :
		- cm-cable-name : name of charger cable
		- extcon : phandles to external connector devices
(optional)	- cm-cable-min : minimum current of cable
(optional)	- cm-cable-max : maximum current of cable

Optional properties :
 - cm-name : charger manager's name (default : "battery")
 - cm-poll-mode : polling mode (enum polling_modes)
 - cm-poll-interval : polling interval
 - cm-battery-stat : battery status (enum data_source)
 - cm-fullbatt-* : data for full battery checking
 - cm-thermal-zone : name of external thermometer's thermal zone
 - cm-battery-* : threshold battery temperature for charging
	-cold : critical cold temperature of battery for charging
	-cold-in-minus : flag that cold temperature is in minus degrees
	-hot : critical hot temperature of battery for charging
	-temp-diff : temperature difference to allow recharging
 - cm-dis/charging-max = limits of charging duration
 - cm-charge-voltage-max: maximum charge voltage in microVolts
 - cm-charge-voltage-drop: drop voltage in microVolts to allow recharging
 - cm-shutdown-voltage: drop voltage in microVolts to allow shutdown
 - cm-tickle-time-out: when 99% of the time is exceeded, it will be forced to 100%
 - cm-one-cap-time: how much time to allow capacity change
 - cm-wdt-interval: the interval to feed charger watchdog
 - cm-jeita-temp-table: An array providing the temperature in degree Celsius,
   the recovery temperature in degree Celsius, the corresponding current and
   the corresponding terminate voltage, which is used to adjust the charging
   current according to different battery temperature to improve charging
   efficiency. The current unit is microamp and terminate voltage unit is microvolt.
Example :
	charger-manager@0 {
		compatible = "charger-manager";
		chg-reg-supply = <&charger_regulator>;

		cm-name = "battery";
		/* Always polling ON : 30s */
		cm-poll-mode = <1>;
		cm-poll-interval = <30000>;

		cm-fullbatt-vchkdrop-ms = <30000>;
		cm-fullbatt-vchkdrop-volt = <150000>;
		cm-fullbatt-soc = <100>;

		cm-battery-stat = <3>;

		cm-num-chargers = <3>;
		cm-chargers = "charger0", "charger1", "charger2";

		cm-fuel-gauge = "fuelgauge0";

		cm-thermal-zone = "thermal_zone.1"
		/* in deci centigrade */
		cm-battery-cold = <50>;
		cm-battery-cold-in-minus;
		cm-battery-hot = <800>;
		cm-battery-temp-diff = <100>;

		/* Allow charging for 5hr */
		cm-charging-max = <18000000>;
		/* Allow discharging for 2hr */
		cm-discharging-max = <7200000>;
		cm-charge-voltage-max = <6500000>;
		cm-charge-voltage-drop = <700000>;
		cm-shutdown-voltage = <3100000>;
		cm-tickle-time-out = <1500>;
		cm-one-cap-time = <30>;
		cm-wdt-interval = <60>;
		cm-jeita-temp-table = <900 930 0 4200000>, <1000 1030 100000 4200000>,
			<1100 1130 500000 4350000>, <1450 1420 0x7fff000 4350000>,
			<1500 1470 700000 4350000>;

		regulator@0 {
			cm-regulator-name = "chg-reg";
			cable@0 {
				cm-cable-name = "USB";
				extcon = <&extcon_usb>;
				cm-cable-min = <475000>;
				cm-cable-max = <500000>;
			};
			cable@1 {
				cm-cable-name = "TA";
				extcon = <&extcon_usb>;
				cm-cable-min = <650000>;
				cm-cable-max = <675000>;
			};
		};

	};
```

## Documentation/devicetree/bindings/power/supply/fan54015_charger.txt
```
FAIRCHILD FAN54015 PMIC battery charger binding

Required properties:
 - compatible: Should be one of the following:
 "fairchild, fan54015_chg",
 "prisemi,psc5415z_chg".
 - reg: Address offset of charger register.
 - phys: Contains a phandle to the USB phy.

Optional Properties:
- monitored-battery: phandle of battery characteristics devicetree node.
  The charger uses the following battery properties:
- charge-term-current-microamp: current for charge termination phase.
- constant-charge-voltage-max-microvolt: maximum constant input voltage.
  See Documentation/devicetree/bindings/power/supply/battery.txt
- extcon: used to detect if vbus is high level.
Example:

	bat: battery {
		compatible = "simple-battery";
		charge-term-current-microamp = <120000>;
		constant-charge-voltage-max-microvolt = <4350000>;
		......
	};

	&i2c4 {
		status = "okay";
		clock-frequency = <400000>;

		fan54015_chg: charger@6a {
			compatible = "fairchild,fan54015_chg";
			reg = <0x6a>;
			phys = <&hsphy>;
			monitored-battery = <&bat>;
			extcon = <&extcon_gpio>;
		};
	};
```

## Documentation/devicetree/bindings/power/supply/sc2703_charger.txt
```
Spreadtrum SC2703 battery charger binding

Required properties:
 - compatible: Should be "sprd,sc2703-charger".
 - reg: Address offset of charger register.
 - phys: Contains a phandle to the USB phy.
 - vddvbus: Provide a handle to the usb module to operate vbus otg.
Optional Properties:
- monitored-battery: phandle of battery characteristics devicetree node.
  The charger uses the following battery properties:
- charge-term-current-microamp: current for charge termination phase.
- constant-charge-voltage-max-microvolt: maximum constant input voltage.
  See Documentation/devicetree/bindings/power/supply/battery.txt
- sprd,long-key-detection: the long key power on configuration option, if
  configured, press 15s the internal battery will disconnect.

Example:

	bat: battery {
		compatible = "simple-battery";
		charge-term-current-microamp = <120000>;
		constant-charge-voltage-max-microvolt = <4350000>;
		......
	};

	sc2703-charger {
		compatible = "sprd,sc2703-charger";
		reg = <0x4c>;
		phys = <&ssphy>;
		monitored-battery = <&bat>;
		sprd,long-key-detection;
		vddvbus:otg-vbus {
			regulator-name = "vddvbus";
			regulator-ramp-delay = <25000>;
		};
	};
```

## Documentation/devicetree/bindings/power/supply/sc2730_fast_chg.txt
```
Spreadtrum SC2730 fast charger binding

Required properties:
 - compatible: Should be "sprd,sc2730-fast-chg".
 - reg: Address offset of charger register.
 - phys: Contains a phandle to the USB phy.
 - interrupt-parent: Specifies the phandle of the interrupt controller to which
 the IRQs from PMIC 2730 are delivered to.
 - interrupts: IRQ line info for sc2730.
 - sprd,input-voltage-microvolt: Specifies the input voltage for fast charging.

Example:

	sc2730-fchg@400 {
		compatible = "sprd,sc2730-fast-chg";
		reg = <0x400>;
		phys = <&ssphy>;
		interrupt-parent = <&sc2730_pmic>;
		interrupts = <5 IRQ_TYPE_LEVEL_HIGH>;
		sprd,input-voltage-microvolt = <9000000>;
	};
```

## Documentation/devicetree/bindings/pwm/pwm-sprd.txt
```
*Spreadtrum SoCs based PWM Subsystem
=============================================

Spreadtrum SoCs contain PWM controller which can be used for system clock
event timers,as well as to drvier SoC output wiht PWM signal.Each controller
provides 4 PWM channels.

Required porperties:
- compatible : Should be one of the following:
		"sprd,sharkl5-pwm"

- reg: base address and size of register area

- clock-names: should contain all following required clock names:
	- "clk_parent" - parent clock for pwm clock,
	- "clk_pwm0" - pwm base clock used to generate PWM signals.
	- "clk_pwm0_eb" - pwm global switch.
	- "clk_pwm1" - pwm base clock used to generate PWM signals.
	- "clk_pwm1_eb" - pwm global switch.
	- "clk_pwm2" - pwm base clock used to generate PWM signals.
	- "clk_pwm2_eb" - pwm global switch.
	- "clk_pwm3" - pwm base clock used to generate PWM signals.
	- "clk_pwm3_eb" - pwm global switch.

- clocks: phandle of the clock used by the PWM module.

See pwm.txt in this directory for a description of the cells format.
More information refer to <Documention/devicetree/bindings/pwm.txt>.

Example:
	pwms: pwm@32260000 {
		compatible = "sprd,sharkl5-pwm";
		reg = <0 0x32260000 0 0x10000>;
		clock-names = "clk_parent",
			"clk_pwm0", "clk_pwm0_eb",
			"clk_pwm1", "clk_pwm1_eb",
			"clk_pwm2", "clk_pwm2_eb",
			"clk_pwm3", "clk_pwm3_eb";
		clocks = <&ext_26m>,
			<&aon_clk CLK_PWM0>, <&aonapb_gate CLK_PWM0_EB>,
			<&aon_clk CLK_PWM1>, <&aonapb_gate CLK_PWM1_EB>,
			<&aon_clk CLK_PWM2>, <&aonapb_gate CLK_PWM2_EB>,
			<&aon_clk CLK_PWM3>, <&aonapb_gate CLK_PWM3_EB>;
		#pwm-cells = <2>;
	};
```
