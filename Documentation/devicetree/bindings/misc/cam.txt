## Documentation/devicetree/bindings/qos/qos-sprd.txt
```
Spreadtrum QOS bindings

Quality of Service (QOS) is designed for reducing the delay between
master, such as arm core/GPU, and DDR by configuring the QOS value
and urgent mechanisms. The urgent mechanism is working with such QOS
threshold. The QOS values and thresholds are limited to binary numbers
in the range of 0x0 to 0xf, where 0x0 represents the lowest priority
and 0xf represents the highest priority. Normally, each master
communicate with DDR in priority order. And when the QOS value is bigger
than the corresponding threshold, which results in 'urgent', this master
will preempt communication rights with DDR.

Required properties:
- reg: Used to distinguish different masters in different sub_systems.

Optional properties:
- arqos: Represents a master's QOS value in issuing read operations
to DDR.
- awqos: Represents a master's QOS value in issuing write operations
to DDR.
- awrqos: Represents a master's QOS value in issuing write and read
operations to DDR.
- arqos-high: If one master has two sets of QOS value, this parameter
repersents the high priority QOS value in issuing read operations to DDR.
- awqos-high: If one master has two sets of QOS value, this parameter
repersents the hith priority QOS value in issuing write opertions to DDR.
- arqos-low: If one master has two sets of QOS value, this parameter
repersents the low priority QOS value in issing read opertions to DDR.
- awqos-low: If one master has two sets of QOS value, this parameter
repersents the low priority QOS value in issing write opertions to DDR.

Note 1: If necessary, the QOS value of different master/sub_systems
can be expressed by suffixing arqos and awqos, like arqos-ce/awqos-dma.

- arqos-threshold: Repersents the urgent threshold in issuing read
operations to DDR.
- awqos-threshold: Repersents the urgent threshold in issuing write
operations to DDR.

Note 2: Thresholds can also have corresponding suffixes, like
arqos-threshold-main and awqos-threshold-merge.

Examples:
	gpu_qos: qos@0 {
			reg = <0>;
			arqos = [06];
			awqos = [06];
			arqos-threshold = [0f];
			awqos-threshold = [0f];
	};
	dpu_qos: qos@1 {
			reg = <1>;
			awqos-high      = [0a];
			awqos-low       = [0a];
			arqos-high      = [0d];
			arqos-low       = [0c];
			arqos-threshold = [0c];
			awqos-threshold = [0f];
	};
	vsp_qos: qos@2 {
			reg = <2>;
			awqos           = [01];
			arqos-high      = [07];
			arqos-low       = [01];
	};
```

## Documentation/devicetree/bindings/regulator/sc2703-regulator.txt
```
* Powerventure Semiconductor PV88080 Voltage Regulator

Required properties:
- compatible: "sprd,sc2703-regulator".
- reg: I2C slave address, 0x49.
- interrupts: the interrupt outputs of the controller
- regulators: A node that houses a sub-node for each regulator within the
  device. Each sub-node is identified using the node's name, with valid
  values listed below. The content of each sub-node is defined by the
  standard binding for regulators; see regulator.txt.
  BUCK1.

Optional properties:
- enable-gpio: Enable external gpio control for the Core BUCK.
	this property should be enable if the OTP value(GPIO control bit) is 1:
	(If SYSCTRL_SEQ_MODE_CONTROL1[bit 0],
	COREBUCK_POWER_CTRL_SELECT bit is 1)
	Please see the datasheet further details.
- sprd,buck-ch1-b-out: Initialize Core BUCK output voltage for SoC special requirement.
- Any optional property defined in regulator.txt

Example

	pmic: sc2703-buck@49 {
		compatible = "sprd,sc2703-buck";
		reg = <0x49>;
		interrupt-parent = <&gpio6>;
		interrupts = <11 IRQ_TYPE_LEVEL_LOW>;

		sprd,buck-ch1-b-out = <1000000>;
		enable-gpio = <&gpio4 10 GPIO_ACTIVE_HIGH>;

		regulator-name = "sc2703-buck";
		regulator-min-microvolt = < 300000>;
		regulator-max-microvolt = <1570000>;
		regulator-min-microamp 	= <5600000>;
		regulator-max-microamp 	= <10800000>;
		regulator-boot-on;
		regulator-always-on;
	};
```

## Documentation/devicetree/bindings/regulator/sprd,cpudvfs-regulator.txt
```
Binding for cpudvfs device regulator
Create a virtual i2c device to adjust the cpu's voltage via an i2c channel

Required properties:
	- compatible: define the compatible property for the i2c device to
	 	      match the specific i2c driver.
	- reg: i2c address
	- dvfs-dcdc-i2c: which dcdc is connected to this i2c.

Example-1:
	cpudvfs@61{
		compatible = "sprd,cpudvfs-regulator-sharkl5";
		reg = <0x61>;
		dvfs-dcdc-i2c = <1>;
	};
```

## Documentation/devicetree/bindings/scheduler/schedutil.txt
```
schedutil governor's DT glue
-----------------------------------------------

This is DT specific glue layer for schedutil governor for sprd systems.

For some SOCs, such as sharkL3, there is no hardware auto scaling for
DVFS under WFI, so, a software slack timer was added in schedutil to
check whether the OPP is the lowest one and scaling to the lowest one
if not.

For some other SOCs with hardware auto scaling for DVFS under WFI, there
is no need to add software slack timer in schedutil.

This property is added to indicate that this SOC need software slack timer
support in schedutil, which help to check the OPP after cpu entered WFI.

Required properties
- sugov_slack_timer
	value type: boolean
	Description: config this property, indicate this SOC need software
	support; else, indicate this SOC no need software support.
	There is no need to add this property into every cpu node, once this
	property is searched in one cpu node, the parsed logic will stop and
	considered this SOC need software support.

Examples:

CPU0: cpu@0 {
	      device_type = "cpu";
	      compatible = "arm,cortex-a55","arm,armv8";
	      reg = <0x0 0x0>;
	      enable-method = "psci";
	      cpu-supply = <&fan53555_dcdc>;
	      cpufreq-data-v1 = <&cpufreq_clus0>;
	      cpu-idle-states = <&CORE_PD>;
	      sched-energy-costs = <&CPU_COST_0 &CLUSTER_COST_0>;
	      capacity-dmips-mhz = <1024>;
	      sugov_slack_timer;
      };
```

## Documentation/devicetree/bindings/sipa/sipa-dele.txt
```
SIPA delegator for Spreadtrum platforms

Required properties:
- compatible: should be one of following:
	"sprd,roc1-sipa-delegate",
	"sprd,orca-sipa-delegate".
- reg: Specify the physical base address of the controller and length
  of memory mapped region.
- sprd,ul-fifo-depth:
	Specify uplink transfer fifo total depth.
- sprd,dl-fifo-depth:
	Specify downlink transfer fifo total depth.

Examples:
	ipa_delegate: sipa-dele@2e000000 {
		compatible = "sprd,roc1-sipa-delegate";
		reg = <0x0 0x2e000000 0 0x00001000>,
		      <0x3 0x8e000000 0 0x00001000>;
		reg-names = "remote-base", "mapped-base";

		sprd,ul-fifo-depth = <1024>;
		sprd,dl-fifo-depth = <1024>;
	};
```

## Documentation/devicetree/bindings/sipa/sipa-sys.txt
```
sipa system for Spreadtrum platforms

Required properties:
- compatible: should be one of following:
	"sprd,roc1-sipa-sys",
	"sprd,roc1-ipa-sys-power-domain".
- syscons: Should contain the base address, offset and bit for each entry in "syscon-names".
- syscon-names: global register bits name, order and name should the same as code.
	ipa-sys-pciepllhsel: clear bit will unbind between PCIEPLL_H and IPA_SYS.
	ipa-sys-pciepllvsel: clear bit will unbind between PCIEPLL_V and IPA_SYS.
	ipa-sys-xtlbufpciehsel: clear bit will unbind between XTLBUF_PCIEH and IPA_SYS.
	ipa-sys-xtlbufpcievsel: clear bit will unbind between XTLBUF_PCIEV and IPA_SYS.
- clocks: Reference to a phandle of a clock provider node, see the common clock bindings.
- clock-names: the following clocks are required:
  * "ipa_core"
  * "ipa_core_source"
Optional Properties:
- vddipa: Provide a handle to the modules ipa_sys to operate power supply.
- #power-domain-cells: Must be 0

Examples:
	pd_ipa_sys: sipa-sys {
		compatible = "sprd,roc1-ipa-sys-power-domain";
		syscons = <&pmu_apb_regs
			  REG_PMU_APB_IPA_FORCE_WAKEUP_CFG
			  MASK_PMU_APB_IPA_FORCE_WAKEUP>,
			  <&pmu_apb_regs
			  REG_PMU_APB_PD_IPA_SYS_CFG
			  MASK_PMU_APB_PD_IPA_SYS_FORCE_SHUTDOWN>,
			  <&pmu_apb_regs
			  REG_PMU_APB_PD_IPA_SYS_CFG
			  MASK_PMU_APB_PD_IPA_SYS_AUTO_SHUTDOWN_EN>,
			  <&pmu_apb_regs
			  REG_PMU_APB_FORCE_DEEP_SLEEP_CFG
			  MASK_PMU_APB_IPA_FORCE_DEEP_SLEEP>,
			  <&pmu_apb_regs
			  REG_PMU_APB_IPA_DSLP_ENA
			  MASK_PMU_APB_IPA_DSLP_ENA>,
			  <&pmu_apb_regs
			  REG_PMU_APB_FORCE_LIGHT_SLEEP_CFG
			  MASK_PMU_APB_IPA_FORCE_LIGHT_SLEEP>,
			  <&pmu_apb_regs
			  REG_PMU_APB_LIGHT_SLEEP_ENABLE
			  MASK_PMU_APB_IPA_LSLP_ENA>,
			  <&pmu_apb_regs
			  REG_PMU_APB_LIGHT_SLEEP_ENABLE
			  MASK_PMU_APB_IPA_SMART_LSLP_ENA>,
			  <&ipa_ahb_regs
			  REG_IPA_AHB_IPA_EB
			  MASK_IPA_AHB_IPA_EB>,
			  <&ipa_ahb_regs
			  REG_IPA_AHB_IPA_EB
			  MASK_IPA_AHB_CM4_EB>,
			  <&ipa_ahb_regs
			  REG_IPA_AHB_MAIN_MTX_LPC
			  MASK_REG_FW0_IPA_S3_LPC_RD_SEC>,
			  <&ipa_ahb_regs
			  REG_IPA_AHB_S5_LPC
			  MASK_REG_FW0_IPA_S3_LPC_WR_SEC>,
			  <&pmu_apb_regs
			  REG_PMU_APB_PCIEPLL_H_REL_CFG
			  MASK_PMU_APB_PCIEPLL_H_IPA_SEL>,
			  <&pmu_apb_regs
			  REG_PMU_APB_PCIEPLL_V_REL_CFG
			  MASK_PMU_APB_PCIEPLL_V_IPA_SEL>,
			  <&pmu_apb_regs
			  REG_PMU_APB_XTLBUF_PCIEH_REL_CFG
			  MASK_PMU_APB_XTLBUF_PCIEH_IPA_SEL>,
			  <&pmu_apb_regs
			  REG_PMU_APB_XTLBUF_PCIEV_REL_CFG
			  MASK_PMU_APB_XTLBUF_PCIEV_IPA_SEL>;

		syscon-names =
			"ipa-sys-forcewakeup",
			"ipa-sys-forceshutdown",
			"ipa-sys-autoshutdown",
			"ipa-sys-forcedslp",
			"ipa-sys-dslpen",
			"ipa-sys-forcelslp",
			"ipa-sys-lslpen",
			"ipa-sys-smartlslpen",
			"ipa-sys-ipaeb",
			"ipa-sys-cm4eb",
			"ipa-sys-autogaten",
			"ipa-sys-s5-autogaten",
			"ipa-sys-pciepllhsel",
			"ipa-sys-pciepllvsel",
			"ipa-sys-xtlbufpciehsel",
			"ipa-sys-xtlbufpcievsel";
		#power-domain-cells = <0>;

		clocks = <&ipa_clk CLK_IPA_CORE>,
			<&g12_pll CLK_LPLL_409M6>;
		clock-names = "ipa_core", "ipa_core_source";

		vddipa:vdd-ipa {
			regulator-name = "IPA_SYS_VPOWER";
		};
	};
```
