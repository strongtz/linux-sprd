## Documentation/devicetree/bindings/watchdog/sprd-wdt.txt
```
Spreadtrum SoCs Watchdog timer

Required properties:
- compatible: should be one of following:
	"sprd,sp9860-wdt",
	"sprd,sharkl3-wdt",
	"sprd,sharkl5-wdt",
	"sprd,sharkl5pro-wdt",
	"sprd,roc1-wdt".
	"sprd,orca-wdt".
	"sprd,pike2-wdt".
- reg : Specifies base physical address and size of the registers.
- interrupts : Exactly one interrupt specifier.
- timeout-sec : Contain the default watchdog timeout in seconds.
- clock-names : Contain the input clock names.
- clocks : Phandles to input clocks.

Example:
	watchdog: watchdog@40310000 {
		compatible = "sprd,sp9860-wdt";
		reg = <0 0x40310000 0 0x1000>;
		interrupts = <GIC_SPI 61 IRQ_TYPE_LEVEL_HIGH>;
		timeout-sec = <12>;
		clock-names = "enable", "rtc_enable";
		clocks = <&clk_aon_apb_gates1 8>, <&clk_aon_apb_rtc_gates 9>;
	};
```

## drivers/clk/sprd/Kconfig
```kconfig
config SPRD_COMMON_CLK
	tristate "Clock support for Spreadtrum SoCs"
	depends on ARCH_SPRD || COMPILE_TEST
	default ARCH_SPRD

if SPRD_COMMON_CLK

# SoC Drivers

config SPRD_SC9860_CLK
	tristate "Support for the Spreadtrum SC9860 clocks"
	depends on (ARM64 && ARCH_SPRD) || COMPILE_TEST
	default ARM64 && ARCH_SPRD

config SPRD_SC9863A_CLK
	tristate "Support for the Spreadtrum Sharkl3 clocks"
	depends on ARCH_SPRD || COMPILE_TEST
	default ARM64 && ARCH_SPRD

config SPRD_SC9832E_CLK
	tristate "Support for the Spreadtrum Sharkle clocks"
	depends on (ARM64 && ARCH_SPRD) || (ARM && ARCH_SPRD) || COMPILE_TEST
	default (ARM64 && ARCH_SPRD) || (ARM && ARCH_SPRD)

config SPRD_SC7731E_CLK
	tristate "Support for the Spreadtrum Pike2 clocks"
	depends on (ARM && ARCH_SPRD) || COMPILE_TEST
	default ARM && ARCH_SPRD

config SPRD_SHARKL5_CLK
	tristate "Support for the Spreadtrum Sharkl5 clocks"
	depends on (ARM64 && ARCH_SPRD) || (ARM && ARCH_SPRD) || COMPILE_TEST
	default (ARM64 && ARCH_SPRD) || (ARM && ARCH_SPRD)

config SPRD_SHARKL5PRO_CLK
	tristate "Support for the Spreadtrum Sharkl5Pro clocks"
	depends on (ARM64 && ARCH_SPRD) || COMPILE_TEST
	default ARM64 && ARCH_SPRD

config SPRD_ROC1_CLK
	tristate "Support for the Spreadtrum ROC1 clocks"
	depends on (ARM64 && ARCH_SPRD) || COMPILE_TEST
	default ARM64 && ARCH_SPRD

config SPRD_ORCA_CLK
	tristate "Support for the Spreadtrum ORCA clocks"
	depends on (ARM64 && ARCH_SPRD) || COMPILE_TEST
	default ARM64 && ARCH_SPRD

endif
```

## drivers/cpuhotplug/Kconfig
```kconfig
#
# Generic cpuhotplug and touchboost drivers configuration
#

menu "CPU Hotplug and touchboost scaling"

config SPRD_CPU_HOTPLUG_GOV
	bool "SPRD CPU hotplug policy"
	depends on HOTPLUG_CPU
        help
          SPRD CPU hotplug policy.
	  And this driver change core number
	  on the basis of load on cpus.

	  Note that this driver will change the num of
	  CPU cores.

	  If in doubt, say N.

endmenu
```

## drivers/gpu/drm/sprd/Kconfig
```kconfig
config DRM_SPRD
	tristate "DRM Support for Spreadtrum SoCs Platform"
	depends on DRM && OF
	select DRM_KMS_HELPER
	select DRM_GEM_CMA_HELPER
	select DRM_KMS_CMA_HELPER
	select DRM_MIPI_DSI
	select DRM_PANEL
	select VIDEOMODE_HELPERS
	select BACKLIGHT_CLASS_DEVICE
	help
	  Choose this option if you have a Spreadtrum chipsets.
	  If M is selected the module will be called sprd-drm.

#
#SPRD DRM GSP driver
#
source "drivers/gpu/drm/sprd/gsp/Kconfig"

config DRM_SPRD_HDMI
	bool "SPRD DRM HDMI DRIVER"
	help
	  Choose this option when you need mipi switch hdmi.
```

## drivers/gpu/drm/sprd/gsp/Kconfig
```kconfig
config DRM_SPRD_GSP
	bool "SPRD DRM GSP driver"
	depends on ARCH_SPRD
	depends on (ION_SPRD_STAGING || ION_SPRD)
	depends on DRM_SPRD
	---help---
	  GSP is hardware which not only can compose multiple layers
	  but also can transform and scale layers.
```

## drivers/iio/sprd_hub/Kconfig
```kconfig
#
# SPRD Sensor Hub drivers configuration
#

menu "Spreadtrum Sensor Hub"

config SPRD_SENSOR_HUB
	tristate "Spreadtrum Sensor Hub"
	select IIO_BUFFER
	select IIO_KFIFO_BUF
	select IIO_TRIGGER
	depends on SPRD_SIPC
	help
	  Support Sensor hub Feature

	  Say Y here to build support for sensor hub.
	  To compile this driver as a module, choose M here

endmenu
```

## drivers/input/touchscreen/adaptive-ts/Kconfig
```kconfig
#
# Adaptive touchscreen module
#

config TOUCHSCREEN_ADAPTIVE
    tristate "adaptive touchscreen driver"
    depends on I2C || SPI_MASTER
    help
      Say Y here to use adaptive touchscreen driver.

if TOUCHSCREEN_ADAPTIVE

source drivers/input/touchscreen/adaptive-ts/vendors/Kconfig

endif
```

## drivers/input/touchscreen/adaptive-ts/vendors/Kconfig
```kconfig
#
# Controller definitions for adaptive touchscreen
#

config TOUCHSCREEN_ADAPTIVE_VENDOR_FOCALTECH
    tristate "Focaltech controller definition for adaptive touchscreen"
    depends on I2C || TOUCHSCREEN_ADAPTIVE
    help
      Say Y here if you have a focaltech based touchscreen controller.

      If unsure, say N.

config TOUCHSCREEN_ADAPTIVE_VENDOR_MSTAR
    tristate "MStar controller definition for adaptive touchscreen"
    depends on I2C || TOUCHSCREEN_ADAPTIVE
    help
      Say Y here if you have a mstar based touchscreen controller.

      If unsure, say N.
```

## drivers/misc/sprd_apdu/Kconfig
```kconfig
config SPRD_APDU
    tristate "Spreadtrum APDU driver"
    default n
    help
      Spreadtrum application protocol data unit driver Support.
```

## drivers/misc/sprd_audio/Kconfig
```kconfig
menu "Spreadtrum Audio Assistant Modules"
config SPRD_AUDIO_AGDSP_ACCESS
	tristate "Sprd audio agdsp access"
	depends on SPRD_MAILBOX
	help
	  This module is used to enable the access
	  of agdsp registers.
	  If audio use audio cp, this config should be selected.
	  If r3p0 vbc is used, this must be set to Y.

config SPRD_AUDIO_MEMORY_MANAGER
	tristate "Sprd audio memory manager"
	help
	  This module is used to manager memories that needed by offlad play(mp3 play),
	  music data buffer used by dma, audio sipc and share memory.
	  If r3p0 vbc is used, this must be set to Y.
	  Say Y if you support audio memory manager.

config SPRD_AUDIO_DSP_DUMP
	tristate "Sprd audio dsp dump"
	depends on SPRD_SIPC
	help
		This module is used to dump dsp log,
		memory and pcm data.
		The main purpers is support debug information.
		Say Y if you support dsp dump.

config SPRD_AUDIO_SIPC
	tristate "Sprd audio sipc"
	depends on SPRD_MAILBOX && SPRD_AUDIO_MEMORY_MANAGER
	help
		This module is used to communication with
		other processor(e.g. agdsp).
		It depends on mailbox and audio memeroy manager.
		Say Y if you support sipc.

config SPRD_AUDIO_SAUDIO
	tristate "Sprd saudio driver in call mode based on sipc"
	depends on SPRD_SIPC
	default N
	help
	  Say Y if you want to built in to kernel, Say M for ko module.
	  SAudio is a bridge to connect AP and CP system.

config SPRD_AUDIO_MCDT
	bool "Spreadtrum MCDT support"
	default n
	help
	  MCDT(Multi-Channel Data Transfer) is a Hardware module
	  that can be used to transfer data between AP and DSP,
	  normally we use it transfer audio data.
	  Say Y if your platform supports hardware MCDT.

config SPRD_HW_DEVICE_DVFS_AGCP
	tristate "Spreadtrum AGCP dvfs driver"
	depends on SPRD_MAILBOX && SPRD_AUDIO_MEMORY_MANAGER
	help
	   This driver supports dvfs interfaces for PUBCP DVFS and WTLCP DVFS at user specidied.

config SPRD_AUDIO_CPBOOT
	tristate "Spreadtrum AGCP boot driver"
	depends on SPRD_AUDIO_MEMORY_MANAGER
	help
	  Audio cp boot driver is used for reboot audio cp in kernel.
	  It support interface for userspace to stop audio cp, download dsp bin and
	  start audio cp.
endmenu
```

## drivers/misc/sprd_audio/mcdt/Kconfig
```kconfig
config SPRD_AUDIO_MCDT
	bool "Spreadtrum MCDT support"
	default n
	help
	  MCDT(Multi-Channel Data Transfer) is a Hardware module
	  that can be used to transfer data between AP and DSP,
	  normally we use it transfer audio data.
	  Say Y if your platform supports hardware MCDT.
```

## drivers/misc/sprd_jpg/Kconfig
```kconfig
config SPRD_JPG
	tristate "SPRD jpg driver"

if SPRD_JPG

config SPRD_JPG_CALL_VSP_PW_DOMAIN
	bool "SPRD jpg call vsp power domain"
	---help---
	say Y if in whale series chip, such as SHARKL3;
	otherwise, N.
	this is to power on jpg domain.

endif
```

## drivers/misc/sprd_vsp/Kconfig
```kconfig
# to add sprd vsp configs in the future
config SPRD_VSP
	tristate "SPRD vsp driver"
	depends on ION_SPRD

config SPRD_VSP_PW_DOMAIN
	bool "SPRD vsp power domain"
	depends on SPRD_VSP
	---help---
	say Y if in whale series chip; otherwise, N.
	this is to power on vsp domain.

config SPRD_VSP_CALL_CAM_PW_DOMAIN
	bool "SPRD VSP call camera power domain"
	depends on SPRD_VSP
	---help---
	say Y if in R6P0 chip, such as PIKE2; otherwise, N.
	this is to power on vsp which calls the interface implemented by camera domain.
```

## drivers/misc/sprdwcn/platform/Kconfig
```kconfig
config WCN_BOOT
	tristate "Core Support"
	help
	Choose Y here if you have this FM radio chip.

	In order to control your ext wcn chip, you will need enable it.
	that include "boot, log, procfs, debugfs, at cmd, loopcheck, dumpmem,
	reset, reboot,etc"

config WCN_UTILS
	bool "wcn debug for read and write register"
	help
	Choose Y here if you need to read/write register of wcn chip,
	this is used for RD debug.

	In order to control or debug your marlin chip, you will need to support
	procfs command to read/write register of marlin chip on.

config WCN_PLATFORM
	tristate "Platform Support"
	depends on SC2342_INTEG
	default y
	help
	Enable this module for Spreadtrum WCN integration
	chip debug and manage function.

	In order to control or debug your marlin chip, you will need to
	support procfs command and memory dump,cp log and so on.

config WCN_SWD
	bool "wcn swd support"
	depends on UMW2653
	help
	Choose Y here if you need to support SWD driver to access arm registers,
	this is used for RD debug.

	In order to control or debug your marlin chip, you will need to support
	swd driver to access arm registers.
```

## drivers/misc/sprdwcn_temp/Kconfig
```kconfig
#
# Spreadtrum WCN device (NEW )configuration
#
menu "Spreadtrum WCN Device Drivers"
config SC23XX
	bool "SC23XX chip Support"
	#depends on MMC
	default n
	help
	  This is support wcn chip for spreadtrum.
	  if you want to use 23xx series wcn chip of spreadtrum.
	  please say "y".

config SC2342_INTEG
	tristate "SC2342 Integrated chip Support"
	depends on SC23XX
	default n
	help
	  This is support wcn chip for spreadtrum.
	  If you want to use sc2342 integrated chip of spreadtrum.
	  Please say "y".

config SC2355
	tristate "SC2355 chip Support"
	depends on SC23XX
	default n
	help
	  This is support wcn chip for spreadtrum.
	  If you want to use sc2355 chip of spreadtrum.
	  Please say "y".

config UMW2652
	tristate "UMW2652 chip Support"
	depends on SC23XX
	default n
	help
	  This is support wcn chip for spreadtrum.
	  If you want to use umw2652 chip of spreadtrum.
	  Please say "y".

# sprd's SDIO device driver based on SC2355...,etc
source "drivers/misc/sprdwcn/sdio/Kconfig"

# sprd's SIPC device driver based on SC2342 integ...,etc
source "drivers/misc/sprdwcn/sipc/Kconfig"

# sprd's sleep device driver based on SC2355...,etc
source "drivers/misc/sprdwcn/sleep/Kconfig"

# sprd's PCIe device driver based on SC2355...,etc
source "drivers/misc/sprdwcn/pcie/Kconfig"

# sprd's wcn platform driver based on SC2355/SC2342...,etc
source "drivers/misc/sprdwcn/platform/Kconfig"

endmenu
```

## drivers/misc/sprdwcn_temp/platform/Kconfig
```kconfig
config WCN_BOOT
	tristate "Core Support"
	help
	Choose Y here if you have this FM radio chip.

	In order to control your ext wcn chip, you will need enable it.
	that include "boot, log, procfs, debugfs, at cmd, loopcheck, dumpmem,
	reset, reboot,etc"

config WCN_UTILS
	bool "wcn debug for read and write register"
	help
	Choose Y here if you need to read/write register of wcn chip,
	this is used for RD debug.

	In order to control or debug your marlin chip, you will need to support
	procfs command to read/write register of marlin chip on.

config WCN_RDCDBG
	bool "wcn kernel_write log and mermory to file"
	help
	Choose Y here if you need to save log and memory not by native server,
	this is used for RD debug.

	In order to control or debug your marlin chip, you will need to support
	save log and mermory auto.

config WCN_PLATFORM
	tristate "Platform Support"
	depends on SC2342_INTEG
	default y
	help
	Enable this module for Spreadtrum WCN integration
	chip debug and manage function.

	In order to control or debug your marlin chip, you will need to
	support procfs command and memory dump,cp log and so on.
```

## drivers/pci/endpoint/functions/Kconfig
```kconfig
#
# PCI Endpoint Functions
#

config PCI_EPF_TEST
	tristate "PCI Endpoint Test driver"
	depends on PCI_ENDPOINT
	select CRC32
	help
	   Enable this configuration option to enable the test driver
	   for PCI Endpoint.

	   If in doubt, say "N" to disable Endpoint test driver.

config PCIE_EPF_SPRD
	tristate "SPRD PCIE Endpoint driver"
	depends on PCI_ENDPOINT
	help
	   Enable this configuration option to enable the SPRD PCIe endpoint
	   function driver.

	   If in doubt, say "N" to disable SPRD PCIe endpoint function driver.
```

## drivers/pinctrl/sprd/Kconfig
```kconfig
#
# Spreadtrum pin control drivers
#

config PINCTRL_SPRD
	bool "Spreadtrum pinctrl driver"
	depends on OF
	depends on ARCH_SPRD || COMPILE_TEST
	select PINMUX
	select PINCONF
	select GENERIC_PINCONF
	select GENERIC_PINMUX_FUNCTIONS
	help
	  Say Y here to enable Spreadtrum pinctrl driver

config PINCTRL_SPRD_SC9860
	bool "Spreadtrum SC9860 pinctrl driver"
	depends on PINCTRL_SPRD
	help
	  Say Y here to enable Spreadtrum SC9860 pinctrl driver

config PINCTRL_SPRD_SHARKL5
        bool "Spreadtrum Sharkl5 pinctrl driver"
        depends on PINCTRL_SPRD
        help
          Say Y here to enable Spreadtrum Sharkl5 pinctrl driver

config PINCTRL_SPRD_ROC1
	bool "Spreadtrum Roc1 pinctrl driver"
	depends on PINCTRL_SPRD
	help
	  Say Y here to enable Spreadtrum Roc1 pinctrl driver

config PINCTRL_SPRD_SHARKL3
	bool "Spreadtrum Sharkl3 pinctrl driver"
	depends on PINCTRL_SPRD
	help
	  Say Y here to enable Spreadtrum Sharkl3 pinctrl driver

config PINCTRL_SPRD_ORCA
	bool "Spreadtrum Orca pinctrl driver"
	depends on PINCTRL_SPRD
	help
	  Say Y here to enable Spreadtrum Orca pinctrl driver

config PINCTRL_SPRD_SHARKL5PRO
	bool "Spreadtrum Sharkl5Pro pinctrl driver"
	depends on PINCTRL_SPRD
	help
	  Say Y here to enable Spreadtrum Sharkl5Pro pinctrl driver

config PINCTRL_SPRD_PIKE2
	bool "Spreadtrum Pike2 pinctrl driver"
	depends on PINCTRL_SPRD
	help
	  Say Y here to enable Spreadtrum Pike2 pinctrl driver

config PINCTRL_SPRD_SHARKLE
	bool "Spreadtrum Sharkle pinctrl driver"
	depends on PINCTRL_SPRD
	help
	  Say Y here to enable Spreadtrum Sharkle pinctrl driver
```
