## Documentation/devicetree/bindings/staging/sc27xx-typec-pd.txt
```
= Spreadtrum SC27XX PMIC Typec Power Delivery device tree bindings =

Required properties:
- compatible: Should be one of the following.
	"sprd,sc2730-typec-pd"
- reg: Specify the address offset of pd controller and typec controller.
- interrupt-parent: phandle for the interrupt controller.
- interrupts: pd interrupt and typec interrupt.

Optional properties :
- sprd,max-sink-mv : Maximum voltage to negotiate when configured as sink
- sprd,max-sink-ma : Maximum current to negotiate when configured as sink
- sprd,max-sink-mw : Maximum power to negotiate when configured as sink If this is less than
		     max-sink-mv * max-sink-ma then the configured current will be clamped.
Example:
	pmic_typec_pd: pd@e00 {
		compatible = "sprd,sc2730-typec-pd";
		reg = <0xe00>, <0x380>;
		interrupt-parent = <&sc2730_pmic>;
		interrupts = <9 IRQ_TYPE_LEVEL_HIGH
			      8 IRQ_TYPE_LEVEL_HIGH>;
		sprd,max-sink-mv = <12000>;
		sprd,max-sink-ma = <3000>;
		sprd,max-sink-mw = <36000>;
	};
```

## Documentation/devicetree/bindings/staging/sprd/sprd,dbg-log.txt
```
dbg-log for Spreadtrum platforms

Required properties:
- compatible: should be one of following:
	"sprd,dbg-log-sharkl3",
	"sprd,dbg-log-sharkl5",
	"sprd,dbg-log-roc1",
	"sprd,dbg-log-orca".
- reg: Specify the physical base address of the controller and length
  	of memory mapped region.
- sprd,syscon-mm-ahb:
	use to get phy mm ahb address.
- sprd,syscon-aon-apb:
	use to get aon apb address.
- sprd,syscon-dsi-apb:
	use to get phy dsi apb address.
- sprd,syscon-pll-apb:
	use to get pll address.
- sprd,ch-name:
	channel name list of serdes function supported by hardware.
- sprd,ch-index:
	channel index list of serdes function supported by hardware.
- sprd,dcfix:
	value of dc_blnc_fix(fix DC balance issue of 8b/10b encoder). set to enable.
- sprd,mm:
	call sprd_cam_pw_on function to power mm on. set to enable.
- vddio-supply:
	To let sensor power on for MIPI SWITCH working. this property is optional.
- mipi-switch-en-gpio:
	enable the MIPI SWITCH
- mipi-switch-mode-gpio:
	select the rear camera for MIPI SWITCH

Examples:
	modem_dbg_log: modem-dbg-log@324f0000 {
		compatible = "sprd,dbg-log-sharkl5";
		reg = <0 0x324f0000 0 0x4000>;
		sprd,syscon-mm-ahb = <&mm_ahb_regs>;
		sprd,syscon-dsi-apb = <&anlg_phy_g10_regs>;
		sprd,ch-name = "TRAINING", "WTL", "MDAR", "TPIU", "DBUS", "WCN";
		sprd,ch-index = <15 1 0 2 3 4>;
		sprd,dcfix;
		sprd,mm;
		status = "disabled";
	};
```

## Documentation/devicetree/bindings/thermal/sc27xx_tsensor_thermal.txt
```
= SC27xx temperature sensor thermal device tree bindings =

Required properties:
- compatible : Should be "sprd,sc2730-tsensor"
- reg : Address range of the tsensor registers
- #thermal-sensor-cells : Should be 1. See ./thermal.txt for a description.
Child nodes properties:
- reg : sensor number id

Example:

	pmic_tsensor: tsensor@1b34 {
		compatible = "sprd,sc27xx-tsensor", "sprd,sc2730-tsensor";
		#thermal-sensor-cells = <1>;
		reg = <0x1b34>;

		osc_tsensor: osc-tsensor@0{
			reg = <0>;
		};

		tout_tsensor: tout-tsensor@1{
			reg = <1>;
		};
	};
```

## Documentation/devicetree/bindings/thermal/sprd-dedicate-thermal.txt
```
= Spreadtrum thermal device tree bindings =

Required properties:
- compatible : Should be "sprd,sharkl3-thermal"
- reg : Address range of the thermal registers
- clock-names: "enable" for thermal module enable clock.
- clocks: Should contain a clock specifier for each entry in clock-names.
- nvmem-cells: A phandle to the calibration data provided by a nvmem device.
- nvmem-cell-names: Should be "cthm_sign_cal" and "cthm_ratio_cal", "thm_delta_cal".

Example:

cpu_thm: cpu-thm@40390000 {
	compatible = "sprd,sharkl3-thermal";
	reg = <0x40390000 0x10000>;
	clock-names = "enable";
	clocks = <&aonapb_gate CLK_THM_EB>;
	#thermal-sensor-cells = <1>;
	nvmem-cells = <&cthm_sign>, <&cthm_ratio>, <&cthm_delta>;
	nvmem-cell-names = "thm_sign_cal", "thm_ratio_cal", "thm_delta_cal";
};
```

## Documentation/devicetree/bindings/thermal/sprd-thermal.txt
```
= Spreadtrum thermal device tree bindings =

Required properties:
- compatible : "sprd,sharkl5-thermal"
- reg : Address range of the thermal registers
- clock-names: "enable" for thermal module enable clock.
- clocks: Should contain a clock specifier for each entry in clock-names.
- reg: sensor number.
- nvmem-cells: A phandle to the calibration data provided by a nvmem device.
- nvmem-cell-names: Should be "thm_sign_cal" and "thm_ratio_cal", in sensor node
		    should is "sen_delta_cal".

Example:

	ap_thm0: thermal@32200000 {
		 compatible = "sprd,sharkl5-thermal";
		 reg = <0 0x32200000 0 0x10000>;
		 clock-names = "enable";
		 clocks = <&aonapb_gate CLK_THM0_EB>;
		 #thermal-sensor-cells = <1>;
		 nvmem-cells = <&thm0_sign>, <&thm0_ratio>;
		 nvmem-cell-names = "thm_sign_cal", "thm_ratio_cal";

		 prometheus0-sensor@0{
				reg = <0>;
				nvmem-cells = <&thm0_sen0>;
				nvmem-cell-names = "sen_delta_cal";
		};

		ank1-sensor@1{
				reg = <1>;
				nvmem-cells = <&thm0_sen1>;
				nvmem-cell-names = "sen_delta_cal";
		};

		.....
		.....
		.....
	};
```

## Documentation/devicetree/bindings/usb/27xx-typec.txt
```
Spreadtrum 27XX TYPEC device tree bindings
================================================================

Required properties:
 - compatible: should be one of the following
		"sprd,sc2730-typec"
 - reg: physical base address of the musb and length of memory mapped region
 - interrupt-parent: phandle for the Interrupt Controller
 - interrupts: typec interrupt of the Interrupt Controller
 - mode: Should specify initial typec mode
	 (0 for DRP mode, 1 for UDP mode, 2 for DRP mode)
 - nvmem-cells: A phandle to the calibration data provided by a nvmem device.
 - nvmem-cell-names: Should be "cc_calib".

Example:
-------
Board specific DT entry:

	pmic_typec: typec@380 {
		compatible = "sprd,sc27xx-typec", "sprd,sc2730-typec";
		interrupt-parent = <&sc2730_pmic>;
		interrupts = <8 IRQ_TYPE_LEVEL_HIGH>;
		reg = <0x380>;
		mode = <2>;
		nvmem-cells = <&cc_cal>;
		nvmem-cell-names = "cc_calib";
	};
```

## Documentation/devicetree/bindings/usb/dwc3-sprd.txt
```
SPRD DWC3 glue logic

This file documents the parameters for the dwc3 driver.
This driver controls the glue logic used to configure the dwc3 core on
ROC1 based platforms.

Required properties:
 - compatible	: must be "sprd,roc1-dwc3", "sprd,orca-dwc3"
 - reg		: glue logic base address and USB syscfg ctrl register offset

 - #address-cells, #size-cells : should be '1' if the device has sub-nodes
   with 'reg' property

 - ranges	: allows valid 1:1 translation between child's address space and
		  parent's address space

 - clocks	: a list of phandle + clock-specifier pairs, one of each
		  entry on clock-names

 - clock-names	: Should contain "core_clk", "ref_clk", "susp_clk".
		  "ipa_usb_ref" and "ipa_usb_ref_source" are optional properties.

 - power-domains : A phandle pointed to the corresponding power domain

Sub-nodes:
The dwc3 core should be added as subnode to SPRD DWC3 glue as shown in the
example below. The DT binding details of dwc3 can be found in:
Documentation/devicetree/bindings/usb/dwc3.txt

NB: The dr_mode property described in [1] is NOT optional for this driver, as the default value
is "otg", which isn't supported by this SoC. Valid dr_mode values for dwc3-sprd are either "host"
or "device".

[1] Documentation/devicetree/bindings/usb/generic.txt

Example:
usb3: usb3@20f00000 {
	compatible = "sprd,roc1-dwc3";
	reg = <0 0x20f00000 0 0x100000>;
	#address-cells = <2>;
	#size-cells = <2>;
	ranges;

	clocks = <&ipa_gate CLK_IPA_USB_EB>,
		<&ipa_gate CLK_IPA_USB_SUSPEND_EB>,
		<&ipa_gate CLK_IPA_USB_REF_EB>;
		<&ipa_clk CLK_USB_REF>,
		<&g12_pll CLK_TWPLL_24M>;
	clock-names = "core_clk", "ref_clk", "susp_clk",
		"ipa_usb_ref", "ipa_usb_ref_source";
	power-domains = <&pd_ipa_sys>;

	dwc3@20f00000 {
		compatible = "synopsys,dwc3";
		reg = <0 0x20f00000 0 0x100000>;
		interrupts = <GIC_SPI 135 IRQ_TYPE_LEVEL_HIGH>;
		interrupt-names = "irq";
		usb-phy = <&ssphy>, <&ssphy>;
		usb-pam = <&pamu3>;
		phy_type = "utmi_wide";
		dr_mode = "peripheral";
		snps,usb3-u1u2-disable;
		snps,dis_u3_susphy_quirk;
		snps,dis_u2_susphy_quirk;
		snps,overlap_check_quirk;
		snps,ep_out_aligned_size_quirk;
		snps,disconnect_event_quirk;
	};
};
```

## Documentation/devicetree/bindings/usb/hsphy.txt
```
Spreadtrum Generic USB PHY
===========================================================

Required properties:
  - compatible: should be one of following:
    "sprd,sharkl3-phy",
    "sprd,sharkl5-phy",
    "sprd,roc1-phy"
    "sprd,pike2-phy"
    "sprd,sharkle-phy"
  - reg: must be the PHY controller base address
  - reg-names: "phy_glb_regs" for the usb phy global register
  - sprd,syscon-enables: specify the handle for aon apb syscon
  - sprd,syscon-apahb: specify the handle for ap ahb syscon
  - sprd,syscon-anag4: specify the handle for anlg_phy_g4 syscon
  - sprd,tune-value: should be set for eye diagram calibration
  - sprd,vdd-voltage: the voltage should be set 3.3V
  - #phy-cells: should be set respectively to <0>

Example
-------

Board specific DT entry:

	hsphy: hsphy@e00000 {
		compatible = "sprd,sharkl3-phy";
		reg = <0xe00000 0x3030>;
		reg-names = "phy_glb_regs";
		sprd,syscon-enable = <&aon_apb_regs>;
		sprd,syscon-apahb = <&ap_ahb_regs>;
		sprd,syscon-anag4 = <&anlg_phy_g4_regs>;
		sprd,tune-value = <0x0005af33>;
		sprd,vdd-voltage = <3300000>;
		#phy-cells = <0>;
	};
```

## Documentation/devicetree/bindings/usb/pamu3.txt
```
Spreadtrum USB PAMU3
===========================================================

Required properties:
  - compatible: should be one of following:
    "sprd,roc1-pamu3",
    "sprd,orca-pamu3"
  - reg: index0 must be the pamu3 base address and length
	index1 must be the dwc3 base address and length
  - reg-names: "pam_glb_regs" for the pamu3 registers
	"dwc3_core_regs" for dwc3 core registers
  - sprd,syscon-ipa-ahb: "ipa_ahb_regs" for ipa ahb syscon

Example
-------

Board specific DT entry:

	pamu3: pamu3@21100000 {
		compatible = "sprd,roc1-pamu3";
		reg = <0 0x21100000 0 0x10000>,
			<0 0x20f00000 0 0x100000>;
		reg-names = "pam_glb_regs",
			"dwc3_core_regs";
		sprd,syscon-ipa-ahb = <&ipa_ahb_regs>;
	};
```

## Documentation/devicetree/bindings/usb/ssphy.txt
```
Spreadtrum Generic USB PHY
===========================================================

Required properties:
  - compatible: should be one of following:
    "sprd,roc1-ssphy", "sprd,orca1-ssphy0", "sprd,orca1-ssphy1"
  - reg: must be the PHY controller base address
  - reg-names: "phy_glb_regs" for the usb phy global register
  - sprd,syscon-enables: specify the handle for aon apb syscon
  - sprd,syscon-ipa-ahb: specify the handle for ap ahb syscon
  - sprd,syscon-anag3: specify the handle for anlg_phy_g4 syscon
  - sprd,syscon-pmu-apb: specify the handle for pmu-apb syscon
  - sprd,vdd-voltage: the voltage should be set 3.3V

Example
-------

Board specific DT entry:

	hsphy: hsphy@e00000 {
		compatible = "sprd,roc1-ssphy";
		reg = <0xe00000 0x3030>;
		reg-names = "phy_glb_regs";
		sprd,syscon-enable = <&aon_apb_regs>;
		sprd,syscon-ipa-ahb = <&ap_ahb_regs>;
		sprd,syscon-anag3 = <&anlg_phy_g4_regs>;
		sprd,syscon-pmu-apb = <&pmu_apb_regs>;
		sprd,vdd-voltage = <3300000>;
	};
```

## Documentation/devicetree/bindings/usb/usb.txt
```
Spreadtrum Generic MUSB driver
================================================================

Required properties:
 - compatible: should be one of the followings:
   "sprd,sharkl3-musb",
   "sprd,sharkl5-musb",
   "sprd,roc1-musb"
   "sprd,pike2-musb"
   "sprd,sharkle-musb"
 - reg: physical base address of the musb and length of memory mapped region
 - interrupts: interrupt number for the musb controller
 - interrupt-names: corresponding interrupt names for the interrupts
                    listed in the 'interrupts'
 - clocks: define which clk to core_clk
 - clock-names: Should contain "core_clk"
 - usb-phy: phandle for the PHY device
 - dr-mode: Should be "peripheral"
 - extcon: Should be "pmic_typec"
 - vbus-supply: Should be "vddvbus" which is provided by charger

Optional properties:
 - wakeup-source: indicate USB irq is wakeup source of AP.
 - syscons: define AON_PUB_SYS_DEEP_SLEEP_POLL in pmu apb
 - syscon-names: should contain "usb_pub_slp_poll"

Example:
-------

Board specific DT entry:

	usb: usb@20200000 {
		compatible  = "sprd,sharkl3-musb";
		reg = <0x20200000 0x2000>;
		interrupts = <GIC_SPI 55 IRQ_TYPE_LEVEL_HIGH>;
		interrupt-names = "mc";
		clocks = <&clk_ap_ahb_gates CLK_OTG_EB>;
		clock-names = "core_clk";
		usb-phy = <&hsphy>;
		phy-names = "usb";
		dr-mode = "peripheral";
		extcon = <&pmic_typec>;
		vbus-supply = <&vddvbus>;
	};
```
