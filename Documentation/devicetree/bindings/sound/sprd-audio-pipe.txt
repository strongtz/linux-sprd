## Documentation/devicetree/bindings/sound/sprd-audio-pipe.txt
```
* Spreadtrum sound audio pipe driver

This node models spreadtrum sound audio pipe driver

Required properties:

- compatible  : "sprd,audio_pipe_voice","sprd,audio_pipe_effect",
	"sprd,audio_pipe_recordproc","sprd,audio_pipe_bthal".
- sprd,writesync :  synchronous or asynchronous for pipe write,
	we can not dependent user space f_flags O_NONBLOCK to decide
	if write to pipe is synchronous or asynchronous, driver guarantee it.
	1 write operation is synchronous
	0 write operation is asynchronous
- sprd,maxuserwritebuffer: buffer max size for userwritebuffer,
	user data size is not fix, we would not alloc too many memory
	to adept all user data size.
- sprd,channel : communication channel with audio co-processor,
	the channel number is defined in "sprd,audio_pipe_voice"
	is for voice process, in "sprd,"audio_pipe_effect"
	is for audio effect function, in "sprd,audio_pipe_recordproc"
	is for audio record process function. These channel number is
	negotiated with audio co-processor.
Example:

audio_pipe_voice {
	compatible = "audio_pipe_voice";
	sprd,writesync = <0>;
	sprd,maxuserwritebufsize = <0>;
	sprd,channel = <2>;
};
```

## Documentation/devicetree/bindings/sound/sprd-codec-dig.txt
```
* Spreadtrum sound audio codec digital driver

This node models spreadtrum sound audio codec digital driver

Required properties:

- compatible = "sprd,audio-codec-dig-agcp", "sprd,sharkl3-audio-codec";
- reg : register address of codec digital
- sprd,syscon-agcp-ahb : node of audio cp ahb
Example:

sprd_audio_codec_dig: audio-codec@33750000 {
	compatible = "sprd,audio-codec-dig-agcp";
	reg = <0 0x33750000 0 0x1000>;
	sprd,syscon-agcp-ahb = <&audcp_ahb_regs>;
};
```

## Documentation/devicetree/bindings/sound/sprd-codec.txt
```
* Spreadtrum cpu dai driver

This node models spreadtrum codec dai driver

Required properties:

- compatible : "sprd,sc2730-audio-codec", "sprd,sc27xx-audio-codec",
- reg : analog codec registor offset
- interrupts : irq num of analog codec
- sprd,syscon-pmu-apb : pmu apb node
- nvmem-cells : A phandle to the calibration cells provided by eFuse device.
- nvmem-cell-names : A name list of nvmem-cells.
- #sound-dai-cells : it used to select codec dai number,
	if equal 0 means use default dai 0, if equal 1,
	the cpu dai number is determined by the second parameter
	of sound-dai property.

Example:
sprd_audio_codec_ana: audio-codec@1000 {
	compatible = "sprd,sc2730-audio-codec", "sprd,sc27xx-audio-codec";
	#sound-dai-cells = <1>;
	reg = <0x1000>;
	interrupts = <8 IRQ_TYPE_NONE>;
	sprd,syscon-pmu-apb = <&pmu_apb_regs>;
};

sprd-audio-card,dai-link@1 {
	...
	codec {
		sound-dai = <&sprd_codec 1>;
	};
	...
};
```

## Documentation/devicetree/bindings/sound/sprd-compress-pcm.txt
```
* Spreadtrum sound compress offload platform driver

This node models spreadtrum sound compress offload platform driver

Required properties:

this node allow sound use sound offload platform driver
- compatible : "sprd,sharkl5-compress-platform", "sprd,roc1-compress-platform"
	"sprd,sharkl5pro-compress-platform"
- dmas : compress used dma channels
- dma-names : dma names of dma channels
- #sound-dai-cells : only support 0, it means use default
    asoc platform.

Example:
sprd_compr: sprd-compr-audio {
	#sound-dai-cells = <0>;
	compatible = "sprd,sharkl5-compress-platform";
	dmas = <&agcp_dma 17 &agcp_dma 18>;
	dma-names = "compr_dma_stage0", "compr_dma_stage1";
};

sprd-audio-card,dai-link@1 {
	...
	plat {
		sound-dai = <&sprd_compr>;
    };
	...
};
```

## Documentation/devicetree/bindings/sound/sprd-headset.txt
```
* Spreadtrum headset driver

This node models spreadtrum headset driver

Required properties:

- compatible : "sprd,headset",
- sprd,jack-type: headset jack type, normal open/close
- io-channels: adc channel used to read headset adc
- io-channel-names: adc channel name
- gpios: TOP EIC GPIO
- sprd,debounce-interval: headset plugin/plugout debounce time
- gpio-names: the GPIO name of TOP EIC
- sprd,3pole-adc-threshold: threshold value to distinguish 3 pole or 4 pole
- sprd,adc-gnd: GND adc value
- sprd,half-adc-gnd: half of GND adc value
- sprd,coefficient: coefficient used to calculate voltage
- sprd,irq-threshold-button: button threshold value
- nvmem-cells: cells used to read efuse value
- nvmem-cell-names: names of cells
- sprd,headset-button: headset key
- adc-min: minimum adc value of a headset key
- adc-max: maximum adc value of a headset key
- code: headset key ID

Optional properties:
- extcon: phandle for the extcon device pmic_typec uses to detect
- mic-gpios: typec analog headset MIC/GND switch
- lr-gpios: typec analog headset LR/USB switch
- switch-supply: typec analog headset power supply
- sprd,switch-voltage: typec analog headset voltage value
- sprd,spk-route-hp: boolean,ext speaker use hp path

Example:
sprd_headset: sprd-headset {
		compatible = "sprd,headset";
		sprd,jack-type = <0>;
		io-channels = <&pmic_adc 20>;
		io-channel-names = "headmic_in_little";
		gpios = <&pmic_eic 6 GPIO_ACTIVE_HIGH>;
		sprd,debounce-interval = <10>;
		gpio-names = "aud_int_all";
		sprd,3pole-adc-threshold = <3054>;
		sprd,adc-gnd = <336>;
		sprd,half-adc-gnd = <131>;
		sprd,coefficient = <906270>;
		sprd,irq-threshold-button = <5>;
		nvmem-cells = <&headset_adc_fir>, <&headset_adc_sec>;
		nvmem-cell-names = "hp_adc_fir_calib", "hp_adc_sec_calib";
		extcon = <&pmic_typec>;
		mic-gpios = <&ap_gpio 52 GPIO_ACTIVE_LOW>;
		lr-gpios = <&ap_gpio 55 GPIO_ACTIVE_LOW>;
		switch-supply = <&vddusb33>;
		sprd,switch-voltage = <3300000>;

		sprd,headset-button@0 {
			adc-min = <0>;
			adc-max = <399>;
			code = <226>;
		};
	};
```

## Documentation/devicetree/bindings/sound/sprd-i2s.txt
```
* Spreadtrum cpu dai driver

This node models spreadtrum dai driver of i2s.

Required properties:

- compatible : "sprd,i2s"
- sprd,config_type : should configured as "i2s" or "pcm",
	driver prepares 2 default configs for i2s and pcm, and this node
	decide to use witch one.
- sprd,slave_timeout : for slave mode, configure timeout length
- sprd,hw_port : i2s hardware port number
- sprd,fs : sample rate
- sprd,bus_type : interface type
	0 i2s, 1 pcm, different form sprd,config_type, it descripts
	i2s interface type of i2s protocal.
- sprd,rtx_mode : transmit-receive mod
	0 idle, 1 receive, 2 transmit, 3 receive and transmit
- sprd,byte_per_chan :byte count for per i2s channel
	0 8bit, 1 16 bit, 2 32 bit, 3 32 bit
- sprd,slave_mode : master mode or slave mode
	0 master, 1 slave
- sprd,lsb : msb or lsb
	0 msb is first bit to transmit, 1 lsb is first bit to transmit
- sprd,lrck : sync_mode
	0 output lrck, 1 sync
- sprd,low_for_left : lrck_inv
	0 low_for_left, 1 high_for_left
- sprd,clk_inv : bit clk invert
	0 not invert, 1 invert
- sprd,pcm_short_frame : pcm_bus_mode
	For short frame: falling edge indicates the start of pcm word,
	PCM_SYNC always one clock cycle long.
	For long frame: rising edge of PCM_SYNC indicates the start of
	pcm word. for master 8bit in one frame PCM_SYNC is 7bit long,
	for slave PCM_SYNC is 2~7.5 long.
- sprd,pcm_slot : pcm slot
	pcm_slot means channel count, support 3 slots.
	pcm data format is difficult for master and slaver, please
	lookup iis spec.
- sprd,pcm_cycle : pcm cycles
	slots use how many cycle, for exsample 8bit for each slot, 3 slot, 4 cycle.
	There will 4 8bit output, 3 8bit is valid, 1 8bit is dymmy.
- sprd,tx_watermark : iis tx watermark for dma request or interrupt,
	not large than 32
- sprd,rx_watermark : iis rx watermark for dma request or interrupt,
	not large than 32
- sprd,i2s_compatible : i2s compatible mode
	i2s_compatible the same bit for pcm_short_frame.
	And for i2s bus mode we call this bit as i2s_compatible.

Example:
i2s configured as 96k 32bit
i2s0: i2s@70c00000  {
	compatible = "sprd,i2s";
	reg = <0x70c00000 0x100000>;
	sprd,dai_name = "i2s_bt_sco0";
	sprd,hw_port = <0>;
	sprd,syscon-ap-apb = <&ap_apb_controller>;
	sprd,config_type = "i2s";
	sprd,slave_timeout = <0xF11>;
	sprd,fs = <96000>;
	sprd,bus_type = <0>;
	sprd,rtx_mode = <3>;
	sprd,byte_per_chan = <2>;
	sprd,slave_mode = <0>;
	sprd,lsb = <0>;
	sprd,lrck = <1>;
	sprd,low_for_left = <0>;
	sprd,clk_inv = <1>;
	sprd,pcm_short_frame = <0>;
	sprd,pcm_slot = <0x1>;
	sprd,pcm_cycle = <1>;
	sprd,tx_watermark = <24>;
	sprd,rx_watermark = <24>;
	sprd,i2s_compatible = <0>;
};
```

## Documentation/devicetree/bindings/sound/sprd-mcdt.txt
```
* Spreadtrum sound audio mcdt driver

This node models spreadtrum sound audio muti channel data trasmit driver

Required properties:

- compatible = "sprd,sharkl5-mcdt", "sprd,roc1-mcdt", "sprd,sharkl5pro-mcdt";
- reg : register addreess and size of mcdt
- interrupts : interrupt number
- sprd,ap-addr-offset : mcdt address mapping offset between ap and audio cp
	used for transform agcp addr from ap addrss of mcdt.

Example:

mcdt@33490000{
	compatible = "sprd,sharkl5-mcdt";
	reg = <0 0x33490000 0 0x170>;
	interrupts = <GIC_SPI 182 IRQ_TYPE_LEVEL_HIGH>;
	sprd,ap-addr-offset = <0x32000000>;
};
```

## Documentation/devicetree/bindings/sound/sprd-pcm.txt
```
* Spreadtrum sound pcm platform driver

This node models spreadtrum sound pcm platform driver

Required properties:

- compatible : "sprd,sharkl5-pcm-platform", "sprd,roc1-pcm-platform", "sprd,sharkl3-pcm-platform",
	"sprd,sharkl5pro-pcm-platform",sprd,7731e-pcm-platform
- dmas : pcm platform used dma channels
- dma-names : dma names of dma channels
- #sound-dai-cells : only support 0, it means use default
	asoc platform.

dmas and dma-names have a one-to-one correspondence.

Example:
sprd_pcm: sprd-pcm-audio {
	compatible = "sprd,sharkl5-pcm-platform";
	#sound-dai-cells = <0>;
	dmas = <&agcp_dma 1 &agcp_dma 2
		&agcp_dma 3 &agcp_dma 4
		&agcp_dma 5 &agcp_dma 6
		&agcp_dma 7 &agcp_dma 8
	dma-names =
		"normal_p_l", "normal_p_r",
		"normal_c_l", "normal_c_r",
		"normal23_p_l", "normal23_p_r",
		"normal23_c_l", "normal23_c_r";
};

sprd-audio-card,dai-link@1 {
	...
	plat {
		sound-dai = <&sprd_pcm>;
	};
	...
};
```

## Documentation/devicetree/bindings/sound/sprd-saudio.txt
```
* Spreadtrum sound audio cp dump driver

This node models spreadtrum sound audio cp dump driver

Required properties:
- compatible : "sprd,saudio"
- sprd,saudio-dst-id : communicate target, should be 5 for pub cp
- sprd,ctrl_channel : communicate channel id, negotiate with pub cp for ctrl command communication
- sprd,playback_channel : communicate channel id, for sblock for playback data transfer pcm data to pubcp
- sprd,capture_channel :  communicate channel id, for sblcok for capture to get pcm data from pubcp
- sprd,monitor_channel :  communicate channel id, negotiate with pub cp when pub cp restart
- sprd,device : pcm device count for playback
- sprd,saudio-names : card names for soundcard

Example:
saudio_lte{
	compatible = "sprd,saudio";
	sprd,saudio-dst-id = <5>;		/* SIPC_ID_LTE */
	sprd,ctrl_channel = <10>;		/* SMSG_CH_VBC */
	sprd,playback_channel = <11 131>; /* SMSG_CH_PLAYBACK */
	sprd,capture_channel = <12>;	/* SMSG_CH_CAPTURE */
	sprd,monitor_channel = <13>;	/*SMSG_CH_MONITOR_AUDIO */
	sprd,device = <2>;
	sprd,saudio-names = "saudiolte";
};
```

## Documentation/devicetree/bindings/sound/sprd-sound-fe.txt
```
* Spreadtrum sound fe driver

This node models spreadtrum sound fe driver

Required properties:

this node allow sound use sound fe dai
- compatible	: "sprd,fe-dai"
- #sound-dai-cells : it used to select cpu dai number,
	if equal 0 means use default dai 0, if equal 1,
	the cpu dai number is determined by the second parameter
	of sound-dai property.

Example:
sprd_fe_dai: sprd-fe-dai {
	compatible = "sprd,fe-dai";
	#sound-dai-cells = <1>;
};

sprd-audio-card,dai-link@1 {
	...
	cpu {
		sound-dai = <&sprd_fe_dai 1>;
	};
	...
};
```

## Documentation/devicetree/bindings/sound/sprd-sound-routing.txt
```
* Spreadtrum sound routing driver

This node models spreadtrum sound routing driver

Required properties:

this node allow sound use sound routing
- compatible : "sprd,pcm-routing"
- #sound-dai-cells : only support 0, it means use default
    asoc platform.

Example:
sprd_route_pcm: sprd-routing-pcm {
	compatible = "sprd,pcm-routing";
	#sound-dai-cells = <0>;
};

sprd-audio-card,dai-link@10 {
	...
	plat {
		sound-dai = <&sprd_route_pcm>;
	};
	...
};
```

## Documentation/devicetree/bindings/sound/sprd-vaudio.txt
```
* Spreadtrum cpu dai driver

This dai for voice call

Required properties:

- compatible : "sprd,vaudio"
- clocks : the tuned clock node that need to wwitch for voice call
- clock-names : the clock name that need to switch for voice call

Example:
This dai for voice call and witch the 26M tuned clock for voice call
&vaudio {
	clocks = <&clk_audio_gate 8>;
	clock-names = "tuned_26m";
};
```

## Documentation/devicetree/bindings/sound/sprd-vbc.txt
```
* Spreadtrum cpu dai driver

This node models spreadtrum cpu dai driver of vbc

Required properties:

- compatible : "sprd,sharkl5-vbc", "sprd,roc1-vbc", "sprd,sharkl5pro-vbc"
- pinctrl-N : One property must exist for each entry in
	pinctrl-names.  See ../pinctrl/sprd,sc9860-pinctrl.txt
	for details of the property values.
- pinctrl-names : vbc iis select port
- reg : registor address and size of vbc
- sprd,syscon-agcp-ahb : audio cp ahb node
- sprd,vbc-phy-offset : vbc address mapping offset of ap and agdsp
	used for transform agcp addr from ap addrss of vbc.
- #sound-dai-cells : it used to select vbc cpu dai number,
    if equal 0 means use default dai 0, if equal 1,
    the cpu dai number is determined by the second parameter
    of sound-dai property.
Example:
vbc@33480000 {
	compatible = "sprd,sharkl5-vbc";
	#sound-dai-cells = <1>;
	reg = <0 0x33480000 0 0x1000>;
	sprd,syscon-agcp-ahb = <&audcp_ahb_regs>;
	sprd,vbc-phy-offset = <0x32000000>;
	/* iis pin map */
	pinctrl-names =
	/* iis interface 0 */
	"vbc_iis3_0", "vbc_iism0_0",
	"vbc_iis_to_pad", "vbc_iis_to_aon_usb";
	pinctrl-0 = <&vbc_iis3_0>;
	pinctrl-1 = <&vbc_iism0_0>;
	pinctrl-2 = <&vbc_iis_to_pad>;
	pinctrl-3 = <&vbc_iis_to_aon_usb>;
};

sprd-audio-card,dai-link@1 {
	...
	cpu {
		sound-dai = <&vbc 1>;
	};
	...
};
```

## Documentation/devicetree/bindings/sound/ucp1301.txt
```
Spreadtrum Communications UCP1301 smart pa bindings

UCP1301 is a high performance, low noise analog audio smart
amplifier with current and voltage sensing ADC inside, which
specialized in music and audio applications with speaker temperature
and membrane excursion protection to avoid speaker damage.

======

Required properties:
- compatible : Should be one of following "sprd,ucp1301-spk", "sprd,ucp1301-spk2", "sprd,ucp1301-rcv"
- reg: I2C slave address, 0x58.
- reset-gpios: a GPIO spec for the reset pin.
- #sound-dai-cells : it used to specify how many cells used when using dai phandle.
	if equal 0 means using default dai 0, if equal 1,
	the dai number is determined by the second parameter of sound-dai property.
======

Example:

	ucp1301_smartpa: ucp1301@58 {
		compatible = "sprd,ucp1301-spk";
		reg = <0x58>;
		reset-gpios = <&ap_gpio 134 GPIO_ACTIVE_HIGH>;
		#sound-dai-cells = <1>;
	};
```
